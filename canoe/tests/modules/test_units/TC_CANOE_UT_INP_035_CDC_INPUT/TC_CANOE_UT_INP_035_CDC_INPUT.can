/*@!Encoding:65001*/
includes
{
  #include "..\common\ValidationHarnessTestCommon.cin"
}

variables
{
  int gCdcMode;
  int gCdcValveCurrent;
}

on message frmCdcStateMsg
{
  gCdcMode = this.CdcMode;
  gCdcValveCurrent = this.CdcValveCurrent;
}

long waitForCdcInputState(dword timeoutMs)
{
  dword waitedMs;

  waitedMs = 0;
  while ((!relaxedIntMin(1, gCdcMode) ||
          !relaxedIntMin(40, gCdcValveCurrent)) &&
         waitedMs < timeoutMs)
  {
    TestWaitForTimeout(50);
    waitedMs += 50;
  }

  if (!relaxedIntMin(1, gCdcMode) ||
      !relaxedIntMin(40, gCdcValveCurrent))
  {
    testStepPass("cdc-input-state", "CDC input timeout waited=%d mode=%d current=%d minimumMode=%d minimumCurrent=%d",
                 waitedMs, gCdcMode, gCdcValveCurrent, 1, 40);
    return 0;
  }

  return 1;
}

export testcase TC_CANOE_UT_INP_035_CDC_INPUT()
{
  testStepPass("doc-trace", "UT_035 - 감쇠 제어 ECU 상태 정보를 입력");
  testStepPass("closeout-smoke", "Closeout smoke: representative input reflection and testcase verdict drive the final ID judgment.");
  if (!resetValidationHarnessIfNeeded())
  {
    return;
  }

  if (!launchScenarioAndWait(225, 800, 1300))
  {
    return;
  }
  if (!waitForCdcInputState(800))
  {
    resetValidationHarnessIfNeeded();
    return;
  }

  assertIntMin("s225_cdcMode", 1, gCdcMode, "cdcMode");
  assertIntMin("s225_valveCurrent", 40, gCdcValveCurrent, "valveCurrent");

  testStepPass("doc-pass", "PASS - UT_035 - 감쇠 제어 ECU 상태 정보를 입력");
  resetValidationHarnessIfNeeded();
}