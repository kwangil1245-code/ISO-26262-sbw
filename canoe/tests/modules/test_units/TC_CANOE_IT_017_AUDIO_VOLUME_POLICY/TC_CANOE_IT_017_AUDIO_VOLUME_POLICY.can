/*@!Encoding:65001*/
includes
{
  #include "..\common\ValidationHarnessTestCommon.cin"
}

variables
{
}

export testcase TC_CANOE_IT_017_AUDIO_VOLUME_POLICY()
{
  testStepPass("doc-trace", "IT_017 - 경보 음량 설정 반영 통합 검증");
  testStepPass("closeout-smoke", "Closeout smoke: representative input reflection and testcase verdict drive the final ID judgment.");
  if (!resetValidationHarnessIfNeeded())
  {
    return;
  }

  if (!launchScenarioAndWait(215, 900, 1700))
  {
    return;
  }

  if (!waitForAudioPolicyFloor(1, 2, 20, -1, 1800))
  {
    resetValidationHarnessIfNeeded();
    return;
  }
  assertIntMin("audio-volume-focus-owner", 1, (long)@CoreState::audioFocusOwner, "audioFocusOwner");
  assertIntMin("audio-volume-ducking", 2, (long)@CoreState::audioDuckingLvl, "audioDuckingLvl");
  assertIntMin("audio-volume-level", 20, (long)@CoreState::volumeLevel, "volumeLevel");

  testStepPass("doc-pass", "PASS - IT_017 - 경보 음량 설정 반영 통합 검증");
  resetValidationHarnessIfNeeded();
}