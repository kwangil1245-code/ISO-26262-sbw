/*@!Encoding:65001*/
includes
{
  #include "..\\common\\ValidationHarnessTestCommon.cin"
}

variables
{
}

export testcase TC_CANOE_IT_CORE_007_AMBIENT_OUTPUT()
{
  testStepPass("doc-trace", "IT_007 - 기본 경고 및 긴급 경고 결과의 앰비언트 출력 통합 검증");
  testStepPass("closeout-smoke", "Closeout smoke: representative input reflection and testcase verdict drive the final ID judgment.");
  if (!resetValidationHarnessIfNeeded())
  {
    return;
  }

  if (!launchScenarioAndWait(4, 700, 1200))
  {
    return;
  }

if (!waitForV2xIngressState(1, 1, 12, 11, 1500) ||
      !waitForCoreSelectedAlertState(6, 1, 800))
  {
    resetValidationHarnessIfNeeded();
    return;
  }

  assertIntEq("selected-alert-level", 6, getCanonicalSelectedAlertLevel(), "selectedAlertLevel");
  assertIntEq("selected-alert-type", 1, getCanonicalSelectedAlertType(), "selectedAlertType");
  assertIntEq("ambient-color", 6, (long)@Body::ambientColor, "ambientColor");
  assertIntEq("ambient-pattern", 6, (long)@Body::ambientPattern, "ambientPattern");

  testStepPass("doc-pass", "PASS - IT_007 - 기본 경고 및 긴급 경고 결과의 앰비언트 출력 통합 검증");
  resetValidationHarnessIfNeeded();
}