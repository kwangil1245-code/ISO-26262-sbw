/*@!Encoding:65001*/
includes
{
  #include "..\common\ValidationHarnessTestCommon.cin"
}

variables
{
  int gMergeConflict;
  int gSideRiskLevel;
}

on message frmSrrFrStateMsg
{
  gMergeConflict = this.MergeConflict;
  gSideRiskLevel = this.SideRiskLevel;
}

export testcase TC_CANOE_UT_INP_059_SRR_FR_INPUT()
{
  testStepPass("doc-trace", "UT_059 - 우전 측후방 레이더 상태를 입력");
  testStepPass("closeout-smoke", "Closeout smoke: representative input reflection and testcase verdict drive the final ID judgment.");
  /* Scenario 22: right-side cut-in / merge conflict scenario.
     Right front SRR detects vehicle merging from adjacent lane.
     ADAS_WARN_CTRL must raise merge cut-in flag via object risk path. */
  if (!resetValidationHarnessIfNeeded())
  {
    return;
  }

  gMergeConflict = -1;
  gSideRiskLevel = -1;
  if (!launchScenarioAndWait(22, 1000, 1200))
  {
    return;
  }

  assertIntEq("s22_srrFrMergeConflict", 1, gMergeConflict, "mergeConflict");
  assertIntEq("s22_obsMergeCutIn", 1, waitForObservedMergeCutIn(1500), "obsMergeCutIn");
  assertIntEq("s22_mergeCutIn", 1, (long)@Test::obsMergeCutInFlag, "mergeCutInFlag");

  testStepPass("doc-pass", "PASS - UT_059 - 우전 측후방 레이더 상태를 입력");
  resetValidationHarnessIfNeeded();
}