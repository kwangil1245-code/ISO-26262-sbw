/*@!Encoding:65001*/
includes
{
  #include "..\common\ValidationHarnessTestCommon.cin"
}

variables
{
}

export testcase TC_CANOE_UT_INP_031_EPB_INPUT()
{
  testStepPass("doc-trace", "UT_031 - 전동 주차 ECU 상태 정보를 입력");
  testStepPass("closeout-smoke", "Closeout smoke: representative input reflection and testcase verdict drive the final ID judgment.");
  if (!resetValidationHarnessIfNeeded())
  {
    return;
  }

  if (!launchScenarioAndWait(216, 800, 1300))
  {
    return;
  }

  if (!waitForCoreDriveState(0, -1, 0, 800) ||
      !waitForCoreChassisState(-1, -1, 30, -1, 800))
  {
    resetValidationHarnessIfNeeded();
    return;
  }

  assertIntEq("s216_driveStateNorm", 0, (long)@Core::driveStateNorm, "driveStateNorm");
  assertIntMin("s216_brakePedalNorm", 30, (long)@Core::brakePedalNorm, "brakePedalNorm");
  assertIntEq("s216_failSafeMode", 0, (long)@Core::failSafeMode, "failSafeMode");

  testStepPass("doc-pass", "PASS - UT_031 - 전동 주차 ECU 상태 정보를 입력");
  resetValidationHarnessIfNeeded();
}