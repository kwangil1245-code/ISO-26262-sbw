/*@!Encoding:65001*/
includes
{
  #include "..\common\ValidationHarnessTestCommon.cin"
}

variables
{
}

export testcase TC_CANOE_IT_015_TURN_LAMP_CONTEXT()
{
  testStepPass("doc-trace", "IT_015 - 방향지시등 상태 기반 경고 타입 보정 통합 검증");
  testStepPass("closeout-smoke", "Closeout smoke: representative input reflection and testcase verdict drive the final ID judgment.");
  if (!resetValidationHarnessIfNeeded())
  {
    return;
  }

  if (!launchScenarioAndWait(239, 900, 1300))
  {
    return;
  }

  if (!waitForCoreSelectedAlertState(3, 6, 800) ||
      !waitForCoreTurnLampState(2, 800))
  {
    resetValidationHarnessIfNeeded();
    return;
  }

  assertIntEq("turn-lamp-context-level", 3, getCanonicalSelectedAlertLevel(), "selectedAlertLevel");
  assertIntEq("turn-lamp-context-type", 6, getCanonicalSelectedAlertType(), "selectedAlertType");
  assertIntEq("turn-lamp-context-state", 2, (long)@CoreState::turnLampState, "turnLampState");

  testStepPass("doc-pass", "PASS - IT_015 - 방향지시등 상태 기반 경고 타입 보정 통합 검증");
  resetValidationHarnessIfNeeded();
}