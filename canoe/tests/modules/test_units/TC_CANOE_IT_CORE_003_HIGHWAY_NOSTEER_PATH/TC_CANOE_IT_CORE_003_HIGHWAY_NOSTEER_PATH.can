/*@!Encoding:65001*/
includes
{
  #include "..\\common\\ValidationHarnessTestCommon.cin"
}

variables
{
}

export testcase TC_CANOE_IT_CORE_003_HIGHWAY_NOSTEER_PATH()
{
  testStepPass("doc-trace", "IT_003 - 고속 구간 무조향 조건과 조향 입력 복귀에 따른 경고 통합 검증");
  testStepPass("closeout-smoke", "Closeout smoke: representative input reflection and testcase verdict drive the final ID judgment.");
  if (!resetValidationHarnessIfNeeded())
  {
    return;
  }

  if (!launchScenarioAndWait(3, 11000, 11600))
  {
    return;
  }

  if (!waitForNavContextState(2, -1, 800) ||
      !waitForCoreSelectedAlertState(2, 4, 800))
  {
    resetValidationHarnessIfNeeded();
    return;
  }

  assertIntEq("selected-alert-level", 2, getCanonicalSelectedAlertLevel(), "selectedAlertLevel");
  assertIntEq("selected-alert-type", 4, getCanonicalSelectedAlertType(), "selectedAlertType");
  assertIntEq("ambient-color", 4, (long)@Body::ambientColor, "ambientColor");
  assertIntEq("ambient-pattern", 4, (long)@Body::ambientPattern, "ambientPattern");

  testStepPass("doc-pass", "PASS - IT_003 - 고속 구간 무조향 조건과 조향 입력 복귀에 따른 경고 통합 검증");
  resetValidationHarnessIfNeeded();
}