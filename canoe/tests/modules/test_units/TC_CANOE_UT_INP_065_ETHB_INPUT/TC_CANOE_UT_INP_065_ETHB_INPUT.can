/*@!Encoding:65001*/
includes
{
  #include "..\common\ValidationHarnessTestCommon.cin"
}

variables
{
}

export testcase TC_CANOE_UT_INP_065_ETHB_INPUT()
{
  testStepPass("doc-trace", "UT_065 - 백본 서비스 상태를 입력");
  testStepPass("closeout-smoke", "Closeout smoke: representative input reflection and testcase verdict drive the final ID judgment.");
  if (!resetValidationHarnessIfNeeded())
  {
    return;
  }

  if (!launchScenarioAndWait(18, 1500, 1000))
  {
    return;
  }

  assertIntEq("s18_obsFailSafe", 1, waitForObservedFailSafeValue(1, 1500), "obsFailSafe");
  assertIntEq("s18_failSafeMode", 1, (long)@Test::obsFailSafeMode, "obsFailSafeMode");
  assertIntEq("s18_coreFailSafe", 1, (long)@Core::failSafeMode, "coreFailSafeMode");

  testStepPass("doc-pass", "PASS - UT_065 - 백본 서비스 상태를 입력");
  resetValidationHarnessIfNeeded();
}