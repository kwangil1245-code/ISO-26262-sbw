/*@!Encoding:65001*/
includes
{
  #include "..\\common\\ValidationHarnessTestCommon.cin"
}

variables
{
}

export testcase TC_CANOE_ST_V2_011_POLICE_OVERRIDE()
{
  testStepPass("doc-trace", "ST_011 - 경찰 긴급 접근이 일반 구간 경고와 동시에 발생할 때 경찰 경고가 우선 표시되는지 확인한다.");
  testStepPass("closeout-smoke", "Closeout smoke: representative input reflection and testcase verdict drive the final ID judgment.");
  if (!resetValidationHarnessIfNeeded())
  {
    return;
  }

  if (!launchScenarioAndWait(11, 800, 1300))
  {
    return;
  }

  if (!waitForObservedSelectedAlertState(6, 1, 800) ||
      !waitForObservedFailSafe(1200))
  {
    resetValidationHarnessIfNeeded();
    return;
  }
  assertIntEq("police-override-level", 6, (long)@Test::obsSelectedAlertLevel, "ethSelectedAlertLevel");
  assertIntEq("police-override-type", 1, (long)@Test::obsSelectedAlertType, "ethSelectedAlertType");
  assertIntMin("police-override-arbitration", 1, (long)@Test::baseTraceSnapshotId, "baseTraceSnapshotId");
  assertIntEq("police-override-failsafe", 0, (long)@Test::obsFailSafeMode, "ethFailSafeMode");

  testStepPass("doc-pass", "PASS - ST_011 - 경찰 긴급 접근이 일반 구간 경고와 동시에 발생할 때 경찰 경고가 우선 표시되는지 확인한다.");
  resetValidationHarnessIfNeeded();
}