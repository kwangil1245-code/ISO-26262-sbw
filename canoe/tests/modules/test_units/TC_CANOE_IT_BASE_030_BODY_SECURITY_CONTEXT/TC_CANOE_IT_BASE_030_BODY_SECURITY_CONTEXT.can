/*@!Encoding:65001*/
includes
{
  #include "..\\common\\ValidationHarnessTestCommon.cin"
}

variables
{
}

export testcase TC_CANOE_IT_BASE_030_BODY_SECURITY_CONTEXT()
{
  testStepPass("doc-trace", "IT_030 - 보안 상태 통합 검증");
  testStepPass("closeout-smoke", "Closeout smoke: representative input reflection and testcase verdict drive the final ID judgment.");
  if (!resetValidationHarnessIfNeeded())
  {
    return;
  }

  if (!launchScenarioAndWait(203, 900, 1500))
  {
    return;
  }

  if (!waitForDiagSemanticState(-1, 1, 1, -1, -1, 1500))
  {
    resetValidationHarnessIfNeeded();
    return;
  }

  assertIntMin("body-security-diag-state", 1, (long)@Diag::SecurityState, "SecurityState");
  assertIntEq("body-security-route-owner", 1, (long)@Diag::RouteOwner, "RouteOwner");

  testStepPass("doc-pass", "PASS - IT_030 - 보안 상태 통합 검증");
  resetValidationHarnessIfNeeded();
}