/*@!Encoding:65001*/
includes
{
  #include "..\common\ValidationHarnessTestCommon.cin"
}

variables
{
}

export testcase TC_CANOE_IT_033_DUPLICATE_POPUP_SUPPRESSION()
{
  testStepPass("doc-trace", "IT_033 - 팝업 과밀 억제와 우선 경고 유지 통합 검증");
  testStepPass("closeout-smoke", "Closeout smoke: representative input reflection and testcase verdict drive the final ID judgment.");
  if (!resetValidationHarnessIfNeeded())
  {
    return;
  }

  if (!launchScenarioAndWait(12, 900, 1400))
  {
    return;
  }

  if (!waitForCoreSelectedAlertState(3, 3, 800) ||
      !waitForDuplicatePopupGuard(1, 800))
  {
    resetValidationHarnessIfNeeded();
    return;
  }

  assertIntMin("duplicate-popup-guard", 1, (long)@CoreState::duplicatePopupGuard, "duplicatePopupGuard");

  testStepPass("doc-pass", "PASS - IT_033 - 팝업 과밀 억제와 우선 경고 유지 통합 검증");
  resetValidationHarnessIfNeeded();
}