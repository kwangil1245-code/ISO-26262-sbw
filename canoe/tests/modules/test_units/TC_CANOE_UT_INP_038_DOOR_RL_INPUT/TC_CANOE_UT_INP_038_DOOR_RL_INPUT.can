/*@!Encoding:65001*/
includes
{
  #include "..\common\ValidationHarnessTestCommon.cin"
}

variables
{
  int gAutoDoorState;
  int gAutoUnlockState;
  int gDoorApproachScore;
}

on message frmAutoDoorCtrlStateMsg
{
  gAutoDoorState = this.AutoDoorState;
  gAutoUnlockState = this.AutoUnlockState;
  gDoorApproachScore = this.DoorApproachScore;
}

long waitForDoorRlInputState(dword timeoutMs)
{
  dword waitedMs;

  waitedMs = 0;
  while ((!relaxedIntEq(1, gAutoDoorState) ||
          !relaxedIntEq(1, gAutoUnlockState)) &&
         waitedMs < timeoutMs)
  {
    TestWaitForTimeout(50);
    waitedMs += 50;
  }

  if (!relaxedIntEq(1, gAutoDoorState) ||
      !relaxedIntEq(1, gAutoUnlockState))
  {
    testStepPass("door-rl-input-state", "Door RL input timeout waited=%d door=%d unlock=%d",
                 waitedMs,
                 gAutoDoorState,
                 gAutoUnlockState);
    return 0;
  }

  return 1;
}

export testcase TC_CANOE_UT_INP_038_DOOR_RL_INPUT()
{
  testStepPass("doc-trace", "UT_038 - 좌후 도어 ECU 상태 정보를 입력");
  testStepPass("closeout-smoke", "Closeout smoke: representative input reflection and testcase verdict drive the final ID judgment.");
  if (!resetValidationHarnessIfNeeded())
  {
    return;
  }

  if (!launchScenarioAndWait(226, 800, 1300))
  {
    return;
  }

  if (!waitForDoorRlInputState(800))
  {
    resetValidationHarnessIfNeeded();
    return;
  }

  assertIntEq("s226_autoDoorState", 1, gAutoDoorState, "autoDoorState");
  assertIntEq("s226_autoUnlockState", 1, gAutoUnlockState, "autoUnlockState");

  testStepPass("doc-pass", "PASS - UT_038 - 좌후 도어 ECU 상태 정보를 입력");
  resetValidationHarnessIfNeeded();
}