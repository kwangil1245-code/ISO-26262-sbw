/*@!Encoding:65001*/
includes
{
  #include "..\\common\\ValidationHarnessTestCommon.cin"
}

variables
{
}

export testcase TC_CANOE_ST_CORE_014_AMBULANCE_DIRECTION_LEFT()
{
  testStepPass("doc-trace", "ST_014 - 구급 긴급 접근 방향(앞/좌/우/후)에 따라 클러스터와 전면 표시의 방향 정보가 정확히 일치하는지 확인한다.");
  testStepPass("closeout-smoke", "Closeout smoke: representative input reflection and testcase verdict drive the final ID judgment.");
  if (!resetValidationHarnessIfNeeded())
  {
    return;
  }

  if (!launchScenarioAndWait(33, 700, 1200))
  {
    return;
  }

  if (!waitForCoreSelectedAlertState(7, 2, 800) ||
      !waitForStableWarningRender(deriveExpectedEmergencyWarningCode(2, 1, 8, 20), 1, 800))
  {
    resetValidationHarnessIfNeeded();
    return;
  }

  assertIntEq("selected-alert-level", 7, getCanonicalSelectedAlertLevel(), "selectedAlertLevel");
  assertIntEq("selected-alert-type", 2, getCanonicalSelectedAlertType(), "selectedAlertType");
  assertIntEq("warning-text-code", deriveExpectedEmergencyWarningCode(2, 1, 8, 20), (long)@Cluster::warningTextCode, "warningTextCode");
  assertIntEq("render-direction", 1, (long)@UiRender::renderDirection, "renderDirection");

  testStepPass("doc-pass", "PASS - ST_014 - 구급 긴급 접근 방향(앞/좌/우/후)에 따라 클러스터와 전면 표시의 방향 정보가 정확히 일치하는지 확인한다.");
  resetValidationHarnessIfNeeded();
}