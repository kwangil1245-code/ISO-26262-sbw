/*@!Encoding:65001*/
includes
{
  #include "..\\common\\ValidationHarnessTestCommon.cin"
}

variables
{
  long gAutoDoorState;
  long gAutoUnlockState;
  long gDoorApproachScore;
  long gTailgateAssistMode;
  long gTailgateOpenReq;
  long gTailgateActuatorCmd;
  long gDeploymentArmed;
  long gPretensionReq;
  long gAirbagWarn;
  long gOccupantDetected;
  long gWeightClass;
  long gAirbagSuppress;
  long gChildSeatDetected;
}

on message frmAutoDoorCtrlStateMsg
{
  gAutoDoorState = this.AutoDoorState;
  gAutoUnlockState = this.AutoUnlockState;
  gDoorApproachScore = this.DoorApproachScore;
}

on message frmPowerTailgateCtrlStateMsg
{
  gTailgateAssistMode = this.TailgateAssistMode;
  gTailgateOpenReq = this.OpenRequestState;
  gTailgateActuatorCmd = this.TailgateActuatorCmd;
}

on message frmAcuStateMsg
{
  gDeploymentArmed = this.DeploymentArmed;
  gPretensionReq = this.PretensionReq;
  gAirbagWarn = this.AirbagWarn;
}

on message frmOdsStateMsg
{
  gOccupantDetected = this.OccupantDetected;
  gWeightClass = this.WeightClass;
  gAirbagSuppress = this.AirbagSuppress;
  gChildSeatDetected = this.ChildSeatDetected;
}

long waitForDoorEntryContext(dword timeoutMs)
{
  dword waitedMs;

  waitedMs = 0;
  while ((gAutoDoorState != 1 ||
          gAutoUnlockState != 1 ||
          gDoorApproachScore < 80) &&
         waitedMs < timeoutMs)
  {
    TestWaitForTimeout(50);
    waitedMs += 50;
  }

  if (gAutoDoorState != 1 ||
      gAutoUnlockState != 1 ||
      gDoorApproachScore < 80)
  {
    testStepPass("door-entry-context", "Door entry timeout waited=%d state=%d unlock=%d score=%d",
                 waitedMs, gAutoDoorState, gAutoUnlockState, gDoorApproachScore);
    return 0;
  }

  return 1;
}

long waitForTailgateContext(dword timeoutMs)
{
  dword waitedMs;

  waitedMs = 0;
  while ((gTailgateAssistMode != 2 ||
          gTailgateOpenReq != 1 ||
          gTailgateActuatorCmd != 0) &&
         waitedMs < timeoutMs)
  {
    TestWaitForTimeout(50);
    waitedMs += 50;
  }

  if (gTailgateAssistMode != 2 ||
      gTailgateOpenReq != 1 ||
      gTailgateActuatorCmd != 0)
  {
    testStepPass("tailgate-context", "Tailgate timeout waited=%d mode=%d open=%d cmd=%d",
                 waitedMs, gTailgateAssistMode, gTailgateOpenReq, gTailgateActuatorCmd);
    return 0;
  }

  return 1;
}

long waitForOccupantContext(dword timeoutMs)
{
  dword waitedMs;

  waitedMs = 0;
  while ((gDeploymentArmed != 0 ||
          gPretensionReq != 1 ||
          gAirbagWarn != 1 ||
          gOccupantDetected != 1 ||
          gWeightClass != 1 ||
          gAirbagSuppress != 1 ||
          gChildSeatDetected != 1) &&
         waitedMs < timeoutMs)
  {
    TestWaitForTimeout(50);
    waitedMs += 50;
  }

  if (gDeploymentArmed != 0 ||
      gPretensionReq != 1 ||
      gAirbagWarn != 1 ||
      gOccupantDetected != 1 ||
      gWeightClass != 1 ||
      gAirbagSuppress != 1 ||
      gChildSeatDetected != 1)
  {
    testStepPass("occupant-context", "Occupant timeout waited=%d armed=%d pretension=%d warn=%d detected=%d weight=%d suppress=%d child=%d",
                 waitedMs, gDeploymentArmed, gPretensionReq, gAirbagWarn, gOccupantDetected, gWeightClass, gAirbagSuppress, gChildSeatDetected);
    return 0;
  }

  return 1;
}

export testcase TC_CANOE_ST_EXT_040_OCCUPANT_COMFORT_CONTEXT()
{
  testStepPass("doc-trace", "ST_040 - 출입, 탑승자 보호, 실내 편의 상태 변화가 시스템 시나리오에서 일관되게 반영되는지 확인한다.");
  testStepPass("closeout-smoke", "Closeout smoke: representative input reflection and testcase verdict drive the final ID judgment.");
  if (!resetValidationHarnessIfNeeded()) { return; }

  gAutoDoorState = -1;
  gAutoUnlockState = -1;
  gDoorApproachScore = -1;
  if (!launchScenarioAndWait(226, 900, 1300)) { return; }
  if (!waitForDoorEntryContext(800)) { resetValidationHarnessIfNeeded(); return; }
  assertIntEq("st-door-entry-state", 1, gAutoDoorState, "AutoDoorState");
  assertIntEq("st-door-entry-unlock", 1, gAutoUnlockState, "AutoUnlockState");
  assertIntMin("st-door-entry-score", 80, gDoorApproachScore, "DoorApproachScore");

  if (!resetValidationHarnessIfNeeded()) { return; }

  gTailgateAssistMode = -1;
  gTailgateOpenReq = -1;
  gTailgateActuatorCmd = -1;
  if (!launchScenarioAndWait(227, 900, 1300)) { return; }
  if (!waitForTailgateContext(800)) { resetValidationHarnessIfNeeded(); return; }
  assertIntEq("st-tailgate-mode", 2, gTailgateAssistMode, "TailgateAssistMode");
  assertIntEq("st-tailgate-open", 1, gTailgateOpenReq, "OpenRequestState");
  assertIntEq("st-tailgate-cmd", 0, gTailgateActuatorCmd, "TailgateActuatorCmd");

  if (!resetValidationHarnessIfNeeded()) { return; }

  gDeploymentArmed = -1;
  gPretensionReq = -1;
  gAirbagWarn = -1;
  gOccupantDetected = -1;
  gWeightClass = -1;
  gAirbagSuppress = -1;
  gChildSeatDetected = -1;
  if (!launchScenarioAndWait(228, 900, 1300)) { return; }
  if (!waitForOccupantContext(800)) { resetValidationHarnessIfNeeded(); return; }
  assertIntEq("st-occupant-armed", 0, gDeploymentArmed, "DeploymentArmed");
  assertIntEq("st-occupant-pretension", 1, gPretensionReq, "PretensionReq");
  assertIntEq("st-occupant-airbag-warn", 1, gAirbagWarn, "AirbagWarn");
  assertIntEq("st-occupant-detected", 1, gOccupantDetected, "OccupantDetected");
  assertIntEq("st-occupant-weight-class", 1, gWeightClass, "WeightClass");
  assertIntEq("st-occupant-airbag-suppress", 1, gAirbagSuppress, "AirbagSuppress");
  assertIntEq("st-occupant-child-seat", 1, gChildSeatDetected, "ChildSeatDetected");

  if (!resetValidationHarnessIfNeeded()) { return; }
  if (!launchScenarioAndWait(229, 1300, 1700)) { return; }
  if (!waitForCoreDriveState(0, 0, 0, 1200)) { resetValidationHarnessIfNeeded(); return; }
  assertIntEq("st-comfort-drive-state", 0, (long)@Core::driveStateNorm, "driveStateNorm");
  assertIntEq("st-comfort-speed", 0, (long)@Core::vehicleSpeedNorm, "vehicleSpeedNorm");
  assertIntEq("st-comfort-failsafe", 0, (long)@Core::failSafeMode, "failSafeMode");
  testStepPass("doc-pass", "PASS - ST_040 - 출입, 탑승자 보호, 실내 편의 상태 변화가 시스템 시나리오에서 일관되게 반영되는지 확인한다.");
  resetValidationHarnessIfNeeded();
}