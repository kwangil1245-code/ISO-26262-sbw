/*@!Encoding:65001*/
includes
{
  #include "..\common\ValidationHarnessTestCommon.cin"
}

variables
{
}

export testcase TC_CANOE_UT_INP_029_NAV_CONTEXT()
{
  testStepPass("doc-trace", "UT_029 - 구간, 방향, 거리(m), 제한속도(km/h) 입력 정보를 생성");
  testStepPass("closeout-smoke", "Closeout smoke: representative input reflection and testcase verdict drive the final ID judgment.");
  if (!resetValidationHarnessIfNeeded())
  {
    return;
  }

  if (!launchScenarioAndWait(2, 800, 1300))
  {
    return;
  }

  if (!waitForNavContextState(1, 30, 800) ||
      !waitForCoreDriveState(-1, -1, 0, 800))
  {
    resetValidationHarnessIfNeeded();
    return;
  }

  assertIntMin("s2_selectedAlertLevel", 3, getCanonicalSelectedAlertLevel(), "selectedAlertLevel");
  assertIntEq("s2_failSafeMode", 0, (long)@Core::failSafeMode, "failSafeMode");

  if (!resetValidationHarnessIfNeeded())
  {
    return;
  }

  if (!launchScenarioAndWait(7, 800, 1300))
  {
    return;
  }

  if (!waitForNavContextState(3, -1, 800) ||
      !waitForCoreDriveState(-1, -1, 0, 800))
  {
    resetValidationHarnessIfNeeded();
    return;
  }

  assertIntEq("s7_failSafeMode", 0, (long)@Core::failSafeMode, "failSafeMode");

  testStepPass("doc-pass", "PASS - UT_029 - 구간, 방향, 거리(m), 제한속도(km/h) 입력 정보를 생성");
  resetValidationHarnessIfNeeded();
}