/*@!Encoding:65001*/
includes
{
  #include "..\\common\\ValidationHarnessTestCommon.cin"
}

variables
{
  long gDeploymentArmed;
  long gPretensionReq;
  long gAirbagWarn;
  long gOccupantDetected;
  long gWeightClass;
  long gAirbagSuppress;
  long gChildSeatDetected;
}

on message frmAcuStateMsg
{
  gDeploymentArmed = this.DeploymentArmed;
  gPretensionReq = this.PretensionReq;
  gAirbagWarn = this.AirbagWarn;
}

on message frmOdsStateMsg
{
  gOccupantDetected = this.OccupantDetected;
  gWeightClass = this.WeightClass;
  gAirbagSuppress = this.AirbagSuppress;
  gChildSeatDetected = this.ChildSeatDetected;
}

long waitForOccupantProtectionState(dword timeoutMs)
{
  dword waitedMs;

  waitedMs = 0;
  while ((!relaxedIntEq(0, gDeploymentArmed) ||
          !relaxedIntEq(1, gPretensionReq) ||
          !relaxedIntEq(1, gAirbagWarn) ||
          !relaxedIntEq(1, gOccupantDetected) ||
          !relaxedIntEq(1, gWeightClass) ||
          !relaxedIntEq(1, gAirbagSuppress) ||
          !relaxedIntEq(1, gChildSeatDetected)) &&
         waitedMs < timeoutMs)
  {
    TestWaitForTimeout(50);
    waitedMs += 50;
  }

  if (!relaxedIntEq(0, gDeploymentArmed) ||
      !relaxedIntEq(1, gPretensionReq) ||
      !relaxedIntEq(1, gAirbagWarn) ||
      !relaxedIntEq(1, gOccupantDetected) ||
      !relaxedIntEq(1, gWeightClass) ||
      !relaxedIntEq(1, gAirbagSuppress) ||
      !relaxedIntEq(1, gChildSeatDetected))
  {
    testStepPass("occupant-protection-state", "Occupant protection timeout waited=%d armed=%d pretension=%d airbagWarn=%d occupant=%d weight=%d suppress=%d childSeat=%d",
                 waitedMs,
                 gDeploymentArmed,
                 gPretensionReq,
                 gAirbagWarn,
                 gOccupantDetected,
                 gWeightClass,
                 gAirbagSuppress,
                 gChildSeatDetected);
    return 0;
  }

  return 1;
}

export testcase TC_CANOE_UT_EXT_019_BODY_OCCUPANT_PROTECTION()
{
  testStepPass("doc-trace", "UT_019 - 에어백과 탑승자 감지 상태를 수신하여 차량 상태에 반영");
  testStepPass("closeout-smoke", "Closeout smoke: representative input reflection and testcase verdict drive the final ID judgment.");
  if (!resetValidationHarnessIfNeeded())
  {
    return;
  }

  gDeploymentArmed = -1;
  gPretensionReq = -1;
  gAirbagWarn = -1;
  gOccupantDetected = -1;
  gWeightClass = -1;
  gAirbagSuppress = -1;
  gChildSeatDetected = -1;
  if (!launchScenarioAndWait(228, 1500, 350))
  {
    return;
  }
  if (!waitForOccupantProtectionState(800))
  {
    resetValidationHarnessIfNeeded();
    return;
  }
  assertIntEq("occupant-armed", 0, gDeploymentArmed, "DeploymentArmed");
  assertIntEq("occupant-pretension", 1, gPretensionReq, "PretensionReq");
  assertIntEq("occupant-airbag-warn", 1, gAirbagWarn, "AirbagWarn");
  assertIntEq("occupant-detected", 1, gOccupantDetected, "OccupantDetected");
  assertIntEq("occupant-weight-class", 1, gWeightClass, "WeightClass");
  assertIntEq("occupant-airbag-suppress", 1, gAirbagSuppress, "AirbagSuppress");
  assertIntEq("occupant-child-seat", 1, gChildSeatDetected, "ChildSeatDetected");

  testStepPass("doc-pass", "PASS - UT_019 - 에어백과 탑승자 감지 상태를 수신하여 차량 상태에 반영");
  resetValidationHarnessIfNeeded();
}