/*@!Encoding:65001*/
includes
{
  #include "..\\common\\ValidationHarnessTestCommon.cin"
}

variables
{
}

export testcase TC_CANOE_UT_OUT_071_IVI_HMI()
{
  testStepPass("doc-trace", "UT_071 - 경고 문구, 거리/방향, 팝업, 테마, 오디오 포커스 정보를 생성하여 표시 채널에 전달");
  testStepPass("closeout-smoke", "Closeout smoke: representative input reflection and testcase verdict drive the final ID judgment.");
  if (!resetValidationHarnessIfNeeded())
  {
    return;
  }

  if (!launchScenarioAndWait(215, 900, 1700))
  {
    return;
  }

  if (!waitForStableWarningRender(deriveExpectedEmergencyWarningCode(1, 2, 11, 40), 2, 1800) ||
      !waitForAudioPolicyFloor(1, 2, 20, -1, 1800))
  {
    resetValidationHarnessIfNeeded();
    return;
  }
  assertIntEq("ivi-hmi-code", deriveExpectedEmergencyWarningCode(1, 2, 11, 40), (long)@Cluster::warningTextCode, "warningTextCode");
  assertIntEq("ivi-hmi-direction", 2, (long)@UiRender::renderDirection, "renderDirection");
  assertIntMin("ivi-hmi-audio-focus", 1, (long)@CoreState::audioFocusOwner, "audioFocusOwner");
  assertIntMin("ivi-hmi-volume", 20, (long)@CoreState::volumeLevel, "volumeLevel");

  if (!resetValidationHarnessIfNeeded())
  {
    return;
  }

  if (!launchScenarioAndWait(220, 900, 1700))
  {
    return;
  }

  if (!waitForStableDisplayPolicy(2, 1, 1, -1, 1800))
  {
    resetValidationHarnessIfNeeded();
    return;
  }
  assertIntEq("ivi-hmi-theme", 2, (long)@CoreState::themeMode, "themeMode");
  assertIntEq("ivi-hmi-popup-active", 1, (long)@CoreState::popupActive, "popupActive");
  assertIntEq("ivi-hmi-popup-priority", 1, (long)@CoreState::popupPriority, "popupPriority");

  if (!resetValidationHarnessIfNeeded())
  {
    return;
  }

  if (!launchScenarioAndWait(222, 900, 1700))
  {
    return;
  }

  if (!waitForStableDistanceHistory(180, deriveExpectedEmergencyWarningCode(1, 2, 9, 72), 1, 1800))
  {
    resetValidationHarnessIfNeeded();
    return;
  }
  assertIntEq("ivi-hmi-distance", 180, (long)@CoreState::emergencyDistanceM, "emergencyDistanceM");
  assertIntEq("ivi-hmi-distance-code", deriveExpectedEmergencyWarningCode(1, 2, 9, 72), (long)@Cluster::warningTextCode, "warningTextCode");
  assertIntEq("ivi-hmi-distance-failsafe", 0, (long)@Core::failSafeMode, "failSafeMode");

  testStepPass("doc-pass", "PASS - UT_071 - 경고 문구, 거리/방향, 팝업, 테마, 오디오 포커스 정보를 생성하여 표시 채널에 전달");
  resetValidationHarnessIfNeeded();
}