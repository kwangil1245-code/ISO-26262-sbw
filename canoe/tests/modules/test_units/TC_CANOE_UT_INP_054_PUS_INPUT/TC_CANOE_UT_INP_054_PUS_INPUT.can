/*@!Encoding:65001*/
includes
{
  #include "..\common\ValidationHarnessTestCommon.cin"
}

variables
{
  int gMinDistanceCm;
  int gProximityClass;
}

on message frmParkUltrasonicStateMsg
{
  gMinDistanceCm = this.MinDistanceCm;
}

on message frmSurroundParkMasterStateMsg
{
  gProximityClass = this.ProximityClass;
}

long waitForParkUltrasonicInputState(dword timeoutMs)
{
  dword waitedMs;

  waitedMs = 0;
  while ((!relaxedIntEq(28, gMinDistanceCm) ||
          !relaxedIntEq(3, gProximityClass)) &&
         waitedMs < timeoutMs)
  {
    TestWaitForTimeout(50);
    waitedMs += 50;
  }

  if (!relaxedIntEq(28, gMinDistanceCm) ||
      !relaxedIntEq(3, gProximityClass))
  {
    testStepPass("park-ultrasonic-input-state", "Park ultrasonic timeout waited=%d dist=%d prox=%d",
                 waitedMs, gMinDistanceCm, gProximityClass);
    return 0;
  }

  return 1;
}

export testcase TC_CANOE_UT_INP_054_PUS_INPUT()
{
  testStepPass("doc-trace", "UT_054 - 주차 초음파 센서 상태를 입력");
  testStepPass("closeout-smoke", "Closeout smoke: representative input reflection and testcase verdict drive the final ID judgment.");
  if (!resetValidationHarnessIfNeeded())
  {
    return;
  }

  if (!launchScenarioAndWait(234, 800, 1300))
  {
    return;
  }
  if (!waitForParkUltrasonicInputState(800))
  {
    resetValidationHarnessIfNeeded();
    return;
  }

  assertIntEq("s234_minDistanceCm", 28, gMinDistanceCm, "minDistanceCm");
  assertIntEq("s234_proximityClass", 3, gProximityClass, "proximityClass");

  testStepPass("doc-pass", "PASS - UT_054 - 주차 초음파 센서 상태를 입력");
  resetValidationHarnessIfNeeded();
}