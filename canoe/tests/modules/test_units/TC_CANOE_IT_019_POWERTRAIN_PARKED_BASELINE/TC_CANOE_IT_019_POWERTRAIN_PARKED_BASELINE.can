/*@!Encoding:65001*/
includes
{
  #include "..\common\ValidationHarnessTestCommon.cin"
}

variables
{
}

export testcase TC_CANOE_IT_019_POWERTRAIN_PARKED_BASELINE()
{
  testStepPass("doc-trace", "IT_019 - 정차 및 Park 상태 기준 파워트레인 상태 반영 통합 검증");
  testStepPass("closeout-smoke", "Closeout smoke: representative input reflection and testcase verdict drive the final ID judgment.");
  if (!resetValidationHarnessIfNeeded())
  {
    return;
  }

  if (!launchScenarioAndWait(216, 1500, 2000))
  {
    return;
  }
  if (!waitForCoreDriveState(0, 0, -1, 1200) ||
      !waitForCoreSelectedAlertState(0, 0, 1200))
  {
    resetValidationHarnessIfNeeded();
    return;
  }

  assertIntEq("powertrain-parked-drive-state", 0, (long)@Core::driveStateNorm, "driveStateNorm");
  assertIntEq("powertrain-parked-speed", 0, (long)@Core::vehicleSpeedNorm, "vehicleSpeedNorm");
  assertIntEq("powertrain-parked-level", 0, getCanonicalSelectedAlertLevel(), "selectedAlertLevel");

  testStepPass("doc-pass", "PASS - IT_019 - 정차 및 Park 상태 기준 파워트레인 상태 반영 통합 검증");
  resetValidationHarnessIfNeeded();
}