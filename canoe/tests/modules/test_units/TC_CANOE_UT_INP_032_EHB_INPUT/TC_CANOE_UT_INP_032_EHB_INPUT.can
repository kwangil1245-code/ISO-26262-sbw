/*@!Encoding:65001*/
includes
{
  #include "..\common\ValidationHarnessTestCommon.cin"
}

variables
{
}

export testcase TC_CANOE_UT_INP_032_EHB_INPUT()
{
  testStepPass("doc-trace", "UT_032 - 제동 보조 ECU 상태 정보를 입력");
  testStepPass("closeout-smoke", "Closeout smoke: representative input reflection and testcase verdict drive the final ID judgment.");
  if (!resetValidationHarnessIfNeeded())
  {
    return;
  }

  if (!launchScenarioAndWait(219, 800, 1300))
  {
    return;
  }
  if (!waitForCoreChassisState(0, 0, 30, 0, 800))
  {
    resetValidationHarnessIfNeeded();
    return;
  }

  assertIntEq("s219_driveStateNorm", 0, (long)@Core::driveStateNorm, "driveStateNorm");
  assertIntMin("s219_brakePedalNorm", 30, (long)@Core::brakePedalNorm, "brakePedalNorm");
  assertIntEq("s219_failSafeMode", 0, (long)@Core::failSafeMode, "failSafeMode");

  testStepPass("doc-pass", "PASS - UT_032 - 제동 보조 ECU 상태 정보를 입력");
  resetValidationHarnessIfNeeded();
}