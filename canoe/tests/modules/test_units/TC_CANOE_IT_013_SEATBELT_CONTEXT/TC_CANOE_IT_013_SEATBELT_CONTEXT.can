/*@!Encoding:65001*/
includes
{
  #include "..\common\ValidationHarnessTestCommon.cin"
}

variables
{
}

export testcase TC_CANOE_IT_013_SEATBELT_CONTEXT()
{
  testStepPass("doc-trace", "IT_013 - 안전벨트 상태 기반 경보 강조 반영 통합 검증");
  testStepPass("closeout-smoke", "Closeout smoke: representative input reflection and testcase verdict drive the final ID judgment.");
  if (!resetValidationHarnessIfNeeded())
  {
    return;
  }

  if (!launchScenarioAndWait(214, 900, 1300))
  {
    return;
  }

  if (!waitForCoreSelectedAlertState(5, 3, 800))
  {
    resetValidationHarnessIfNeeded();
    return;
  }

  assertIntEq("seatbelt-context-level", 5, getCanonicalSelectedAlertLevel(), "selectedAlertLevel");
  assertIntEq("seatbelt-context-type", 3, getCanonicalSelectedAlertType(), "selectedAlertType");

  testStepPass("doc-pass", "PASS - IT_013 - 안전벨트 상태 기반 경보 강조 반영 통합 검증");
  resetValidationHarnessIfNeeded();
}