/*@!Encoding:65001*/
includes
{
  #include "..\\common\\ValidationHarnessTestCommon.cin"
}

variables
{
}

export testcase TC_CANOE_UT_EXT_016_CHS_BRAKE_EXT()
{
  testStepPass("doc-trace", "UT_016 - 전동 주차와 제동 보조 상태를 수신하여 경고 판단 경로에 전달");
  testStepPass("closeout-smoke", "Closeout smoke: representative input reflection and testcase verdict drive the final ID judgment.");
  if (!resetValidationHarnessIfNeeded())
  {
    return;
  }

  if (!launchScenarioAndWait(216, 800, 1300))
  {
    return;
  }
  if (!waitForCoreDriveState(0, 0, -1, 800))
  {
    resetValidationHarnessIfNeeded();
    return;
  }
  assertIntEq("chs-brake-park-drive", 0, (long)@Core::driveStateNorm, "driveStateNorm");
  assertIntMin("chs-brake-park-pedal", 30, (long)@Core::brakePedalNorm, "brakePedalNorm");

  if (!resetValidationHarnessIfNeeded())
  {
    return;
  }
  if (!launchScenarioAndWait(219, 800, 1300))
  {
    return;
  }
  if (!waitForCoreChassisState(0, 0, 30, 0, 800))
  {
    resetValidationHarnessIfNeeded();
    return;
  }
  assertIntEq("chs-brake-stop-drive", 0, (long)@Core::driveStateNorm, "driveStateNorm");
  assertIntMin("chs-brake-stop-pedal", 30, (long)@Core::brakePedalNorm, "brakePedalNorm");
  assertIntEq("chs-brake-stop-failsafe", 0, (long)@Core::failSafeMode, "failSafeMode");

  testStepPass("doc-pass", "PASS - UT_016 - 전동 주차와 제동 보조 상태를 수신하여 경고 판단 경로에 전달");
  resetValidationHarnessIfNeeded();
}