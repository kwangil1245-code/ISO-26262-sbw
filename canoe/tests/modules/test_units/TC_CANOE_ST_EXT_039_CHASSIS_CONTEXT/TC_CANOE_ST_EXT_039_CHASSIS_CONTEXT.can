/*@!Encoding:65001*/
includes
{
  #include "..\\common\\ValidationHarnessTestCommon.cin"
}

variables
{
}

long waitForDriveModeState(long expectedDriveMode,
                           dword timeoutMs)
{
  dword waitedMs;

  waitedMs = 0;
  while ((long)@CoreState::driveMode != expectedDriveMode &&
         waitedMs < timeoutMs)
  {
    TestWaitForTimeout(50);
    waitedMs += 50;
  }

  if ((long)@CoreState::driveMode != expectedDriveMode)
  {
    testStepPass("st-chassis-drive-mode-wait",
                 "Drive mode timeout waited=%d driveMode=%d expected=%d",
                 waitedMs,
                 (long)@CoreState::driveMode,
                 expectedDriveMode);
    return 0;
  }

  return 1;
}

export testcase TC_CANOE_ST_EXT_039_CHASSIS_CONTEXT()
{
  testStepPass("doc-trace", "ST_039 - 제동 및 차체 안정화 상태 변화가 시스템 시나리오에서 경고 맥락에 일관되게 반영되는지 확인한다.");
  testStepPass("closeout-smoke", "Closeout smoke: representative input reflection and testcase verdict drive the final ID judgment.");
  if (!resetValidationHarnessIfNeeded()) { return; }
  if (!launchScenarioAndWait(218, 900, 1300)) { return; }
  if (!waitForCoreChassisState(68, 1, -1, -1, 800)) { resetValidationHarnessIfNeeded(); return; }
  assertIntEq("st-chassis-steer-input", 1, (long)@Core::steeringInputNorm, "steeringInputNorm");
  if (!resetValidationHarnessIfNeeded()) { return; }
  if (!launchScenarioAndWait(219, 900, 1300)) { return; }
  if (!waitForCoreChassisState(-1, -1, 30, -1, 800)) { resetValidationHarnessIfNeeded(); return; }
  assertIntMin("st-chassis-brake-pedal", 30, (long)@Core::brakePedalNorm, "brakePedalNorm");
  if (!resetValidationHarnessIfNeeded()) { return; }
  if (!launchScenarioAndWait(237, 900, 1300)) { return; }
  if (!waitForDriveModeState(2, 800)) { resetValidationHarnessIfNeeded(); return; }
  assertIntEq("st-chassis-drive-mode", 2, (long)@CoreState::driveMode, "driveMode");
  testStepPass("doc-pass", "PASS - ST_039 - 제동 및 차체 안정화 상태 변화가 시스템 시나리오에서 경고 맥락에 일관되게 반영되는지 확인한다.");
  resetValidationHarnessIfNeeded();
}