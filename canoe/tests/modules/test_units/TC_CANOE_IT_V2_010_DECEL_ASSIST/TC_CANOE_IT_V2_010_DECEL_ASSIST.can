/*@!Encoding:65001*/
includes
{
  #include "..\\common\\ValidationHarnessTestCommon.cin"
}

variables
{
}

export testcase TC_CANOE_IT_V2_010_DECEL_ASSIST()
{
  testStepPass("doc-trace", "IT_010 - 긴급차량 근접 위험도 기반 감속 보조 요청과 경고 출력 통합 검증");
  testStepPass("closeout-smoke", "Closeout smoke: representative input reflection and testcase verdict drive the final ID judgment.");
  if (!resetValidationHarnessIfNeeded())
  {
    return;
  }

  if (!launchScenarioAndWait(19, 800, 1300))
  {
    return;
  }

  if (!waitForObservedDecelState(1, 1, 0, 1500) ||
      !waitForObservedSelectedAlertState(7, 2, 1500) ||
      !waitForObservedFailSafe(1200))
  {
    resetValidationHarnessIfNeeded();
    return;
  }
  assertIntEq("decel-decision-req", 1, (long)@Test::obsDecelDecisionReq, "ethDecelDecisionReq");
  assertIntEq("decel-assist-req", 1, (long)@Test::obsDecelAssistReq, "ethDecelAssistReq");
  assertIntEq("decel-gate-clear", 0, (long)@Test::obsDecelGateReason, "ethDecelGateReason");
  assertLongGe("proximity-risk-level", (long)@Test::obsDecelRisk, 70, "ethDecelRisk");
  assertIntEq("selected-alert-level", 7, (long)@Test::obsSelectedAlertLevel, "ethSelectedAlertLevel");
  assertIntEq("selected-alert-type", 2, (long)@Test::obsSelectedAlertType, "ethSelectedAlertType");
  assertIntEq("fail-safe-clear", 0, (long)@Test::obsFailSafeMode, "ethFailSafeMode");

  testStepPass("doc-pass", "PASS - IT_010 - 긴급차량 근접 위험도 기반 감속 보조 요청과 경고 출력 통합 검증");
  resetValidationHarnessIfNeeded();
}