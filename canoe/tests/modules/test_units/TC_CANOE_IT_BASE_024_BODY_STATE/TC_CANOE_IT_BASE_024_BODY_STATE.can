/*@!Encoding:65001*/
includes
{
  #include "..\\common\\ValidationHarnessTestCommon.cin"
}

variables
{
}

export testcase TC_CANOE_IT_BASE_024_BODY_STATE()
{
  testStepPass("doc-trace", "IT_024 - 비상등 상태 기준 body 반영 통합 검증");
  testStepPass("closeout-smoke", "Closeout smoke: representative input reflection and testcase verdict drive the final ID judgment.");
  if (!resetValidationHarnessIfNeeded())
  {
    return;
  }

  if (!launchScenarioAndWait(211, 900, 1300))
  {
    return;
  }

  if (!waitForCoreSelectedAlertState(6, -1, 800) ||
      !waitForCoreTurnLampState(3, 800))
  {
    resetValidationHarnessIfNeeded();
    return;
  }

  assertIntEq("body-hazard-turnlamp", 3, (long)@CoreState::turnLampState, "turnLampState");
  assertIntEq("body-hazard-level", 6, getCanonicalSelectedAlertLevel(), "selectedAlertLevel");

  testStepPass("doc-pass", "PASS - IT_024 - 비상등 상태 기준 body 반영 통합 검증");
  resetValidationHarnessIfNeeded();
}