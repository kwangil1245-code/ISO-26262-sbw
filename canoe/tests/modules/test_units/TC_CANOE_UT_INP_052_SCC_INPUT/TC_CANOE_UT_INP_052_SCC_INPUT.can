/*@!Encoding:65001*/
includes
{
  #include "..\common\ValidationHarnessTestCommon.cin"
}

export testcase TC_CANOE_UT_INP_052_SCC_INPUT()
{
  testStepPass("doc-trace", "UT_052 - 주행 보조 ECU 상태 정보를 입력");
  testStepPass("closeout-smoke", "Closeout smoke: representative input reflection and testcase verdict drive the final ID judgment.");
  /* Scenario 16: proximity decel scenario.
     Current DBC has no dedicated SCC state frame, so this TC closes on the
     scenario contract through the decel-assist observer and Core state. */
  if (!resetValidationHarnessIfNeeded())
  {
    return;
  }

  if (!launchScenarioAndWait(16, 1000, 1200))
  {
    return;
  }

  assertIntEq("s16_obsDecelState", 1, waitForObservedDecelState(1, 1, 0, 1500), "obsDecelState");
  assertIntEq("s16_decelDecisionReq", 1, (long)@Test::obsDecelDecisionReq, "decelDecisionReq");
  assertIntEq("s16_decelAssistReq", 1, (long)@Test::obsDecelAssistReq, "decelAssistReq");
  assertIntEq("s16_decelGateReason", 0, (long)@Test::obsDecelGateReason, "decelGateReason");
  assertIntEq("s16_coreDecelAssistReq", 1, (long)@Core::decelAssistReq, "coreDecelAssistReq");

  testStepPass("doc-pass", "PASS - UT_052 - 주행 보조 ECU 상태 정보를 입력");
  resetValidationHarnessIfNeeded();
}