/*@!Encoding:65001*/
includes
{
  #include "..\\common\\ValidationHarnessTestCommon.cin"
}

variables
{
}

export testcase TC_CANOE_UT_OUT_072_CLU_DISPLAY()
{
  testStepPass("doc-trace", "UT_072 - 경고 문구와 팝업, 테마 정보를 수신하여 클러스터 표시에 반영");
  testStepPass("closeout-smoke", "Closeout smoke: representative input reflection and testcase verdict drive the final ID judgment.");
  if (!resetValidationHarnessIfNeeded())
  {
    return;
  }

  if (!launchScenarioAndWait(30, 700, 1200))
  {
    return;
  }

  if (!waitForStableWarningRender(deriveExpectedEmergencyWarningCode(1, 2, 12, 20), 2, 1800))
  {
    resetValidationHarnessIfNeeded();
    return;
  }
  assertIntEq("clu-police-code", deriveExpectedEmergencyWarningCode(1, 2, 12, 20), (long)@Cluster::warningTextCode, "warningTextCode");
  assertIntEq("clu-police-direction", 2, (long)@UiRender::renderDirection, "renderDirection");

  if (!resetValidationHarnessIfNeeded())
  {
    return;
  }

  if (!launchScenarioAndWait(33, 700, 1200))
  {
    return;
  }

  if (!waitForStableWarningRender(deriveExpectedEmergencyWarningCode(2, 1, 8, 20), 1, 1800))
  {
    resetValidationHarnessIfNeeded();
    return;
  }
  assertIntEq("clu-ambulance-code", deriveExpectedEmergencyWarningCode(2, 1, 8, 20), (long)@Cluster::warningTextCode, "warningTextCode");
  assertIntEq("clu-ambulance-direction", 1, (long)@UiRender::renderDirection, "renderDirection");

  if (!resetValidationHarnessIfNeeded())
  {
    return;
  }

  if (!launchScenarioAndWait(220, 900, 1300))
  {
    return;
  }

  if (!waitForStableDisplayPolicy(2, 1, 1, 1, 1800))
  {
    resetValidationHarnessIfNeeded();
    return;
  }
  assertIntEq("clu-theme", 2, (long)@CoreState::themeMode, "themeMode");
  assertIntEq("clu-popup-active", 1, (long)@CoreState::popupActive, "popupActive");
  assertIntEq("clu-cluster-sync", 1, (long)@CoreState::clusterSyncState, "clusterSyncState");

  testStepPass("doc-pass", "PASS - UT_072 - 경고 문구와 팝업, 테마 정보를 수신하여 클러스터 표시에 반영");
  resetValidationHarnessIfNeeded();
}