/*@!Encoding:65001*/
includes
{
  #include "..\\common\\ValidationHarnessTestCommon.cin"
}

variables
{
}

export testcase TC_CANOE_ST_EXT_013_CHANNEL_CONTENTION()
{
  if (!resetValidationHarnessIfNeeded())
  {
    return;
  }

  if (!launchScenarioAndWait(215, 900, 1300))
  {
    return;
  }

  assertIntEq("channel-contention-audio-pass", 1, (long)@Test::scenarioResult, "scenarioResult");
  assertIntEq("channel-contention-audio-focus", 1, (long)@CoreState::audioFocusOwner, "audioFocusOwner");
  assertIntEq("channel-contention-audio-ducking", 4, (long)@CoreState::audioDuckingLvl, "audioDuckingLvl");
  assertIntEq("channel-contention-audio-volume", 80, (long)@CoreState::volumeLevel, "volumeLevel");

  if (!resetValidationHarnessIfNeeded())
  {
    return;
  }

  if (!launchScenarioAndWait(220, 900, 1300))
  {
    return;
  }

  assertIntEq("channel-contention-visual-pass", 1, (long)@Test::scenarioResult, "scenarioResult");
  assertIntEq("channel-contention-popup-active", 1, (long)@CoreState::popupActive, "popupActive");
  assertIntEq("channel-contention-popup-priority", 1, (long)@CoreState::popupPriority, "popupPriority");
  assertIntEq("channel-contention-cluster-sync", 1, (long)@CoreState::clusterSyncState, "clusterSyncState");
  if (!waitForObservedFailSafe(800)) { resetValidationHarnessIfNeeded(); return; }
  assertIntEq("channel-contention-failsafe", 0, (long)@Test::obsFailSafeMode, "ethFailSafeMode");

  resetValidationHarnessIfNeeded();
}
