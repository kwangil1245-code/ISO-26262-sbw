/*@!Encoding:65001*/
includes
{
  #include "..\\common\\ValidationHarnessTestCommon.cin"
}

variables
{
}

export testcase TC_CANOE_IT_BASE_002_CHASSIS_STATE()
{
  if (!resetValidationHarnessIfNeeded())
  {
    return;
  }

  if (!launchScenarioAndWait(218, 900, 1300))
  {
    return;
  }

  assertIntEq("chassis-steer-pass", 1, (long)@Test::scenarioResult, "scenarioResult");
  assertIntEq("chassis-steer-speed", 68, (long)@Core::vehicleSpeedNorm, "vehicleSpeedNorm");
  assertIntEq("chassis-steer-input", 1, (long)@Core::steeringInputNorm, "steeringInputNorm");
  assertIntEq("chassis-steer-brake", 0, (long)@Core::brakePedalNorm, "brakePedalNorm");

  if (!resetValidationHarnessIfNeeded())
  {
    return;
  }

  if (!launchScenarioAndWait(219, 900, 1300))
  {
    return;
  }

  assertIntEq("chassis-brake-pass", 1, (long)@Test::scenarioResult, "scenarioResult");
  assertIntEq("chassis-brake-drive-state", 0, (long)@Core::driveStateNorm, "driveStateNorm");
  assertIntEq("chassis-brake-speed", 0, (long)@Core::vehicleSpeedNorm, "vehicleSpeedNorm");
  assertIntEq("chassis-brake-steer", 0, (long)@Core::steeringInputNorm, "steeringInputNorm");
  assertIntMin("chassis-brake-pedal", 30, (long)@Core::brakePedalNorm, "brakePedalNorm");

  if (!resetValidationHarnessIfNeeded())
  {
    return;
  }

  if (!launchScenarioAndWait(237, 900, 1300))
  {
    return;
  }

  assertIntEq("chassis-accel-pass", 1, (long)@Test::scenarioResult, "scenarioResult");
  assertIntEq("chassis-accel-drive-state", 3, (long)@Core::driveStateNorm, "driveStateNorm");
  assertIntEq("chassis-accel-speed", 140, (long)@Core::vehicleSpeedNorm, "vehicleSpeedNorm");
  assertIntEq("chassis-accel-drive-mode", 2, (long)@CoreState::driveMode, "driveMode");
  assertIntEq("chassis-accel-sport-mode", 1, (long)@CoreState::sportMode, "sportMode");

  resetValidationHarnessIfNeeded();
}