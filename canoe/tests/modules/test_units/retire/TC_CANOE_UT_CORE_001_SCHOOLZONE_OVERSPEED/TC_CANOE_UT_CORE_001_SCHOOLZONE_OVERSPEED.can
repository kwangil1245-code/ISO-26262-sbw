/*@!Encoding:65001*/
includes
{
  #include "..\\common\\ValidationHarnessTestCommon.cin"
}

variables
{
}

export testcase TC_CANOE_UT_CORE_001_SCHOOLZONE_OVERSPEED()
{
  if (!resetValidationHarnessIfNeeded())
  {
    return;
  }

  if (!launchScenarioAndWait(2, 1500, 1200))
  {
    return;
  }

  assertIntEq("scenario-pass", 1, (long)@Test::scenarioResult, "scenarioResult");
  assertIntEq("drive-state", 3, (long)@Core::driveStateNorm, "driveStateNorm");
  assertIntEq("vehicle-speed", 45, (long)@Core::vehicleSpeedNorm, "vehicleSpeedNorm");
  assertIntEq("speed-limit", 30, (long)@Core::speedLimitNorm, "speedLimitNorm");
  assertIntEq("zone-context", 1, (long)@Core::baseZoneContext, "baseZoneContext");
  assertIntEq("warning-state", 1, (long)@Core::warningState, "warningState");
  assertIntEq("alert-level", 3, (long)@Core::selectedAlertLevel, "selectedAlertLevel");
  assertIntEq("alert-type", 3, (long)@Core::selectedAlertType, "selectedAlertType");
  assertIntEq("cluster-code", 33, (long)@Cluster::warningTextCode, "warningTextCode");
  assertIntEq("ambient-color", 3, (long)@Body::ambientColor, "ambientColor");
  assertIntEq("ambient-pattern", 5, (long)@Body::ambientPattern, "ambientPattern");

  resetValidationHarnessIfNeeded();
}
