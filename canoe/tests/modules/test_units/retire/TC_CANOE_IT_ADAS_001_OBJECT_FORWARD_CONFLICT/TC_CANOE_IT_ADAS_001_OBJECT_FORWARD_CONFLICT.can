/*@!Encoding:65001*/
includes
{
  #include "..\common\ValidationHarnessTestCommon.cin"
}

variables
{
}

export testcase TC_CANOE_IT_ADAS_001_OBJECT_FORWARD_CONFLICT()
{
  // Dev2 blueprint intent: forward object TTC conflict path without emergency dependency
  // Pack: native_functional_6
  // Draft skeleton only: Dev1 must bind exact runtime messages/signals/asserts before enabling this asset in the mandatory suite.
  // Scenario ID: 20
  if (!resetValidationHarnessIfNeeded())
  {
    return;
  }

  if (!launchScenarioAndWait(20, 1500, 1200))
  {
    return;
  }

  testStepPass("blueprint-intent", "Intent: forward object TTC conflict path without emergency dependency");
  testStepPass("oracle-guide-1", "Expected: scenario result pass");
  testStepPass("oracle-guide-2", "Expected: object tracking valid");
  testStepPass("oracle-guide-3", "Expected: risk class elevated");
  testStepPass("oracle-guide-4", "Expected: proximity risk reflected");
  testStepPass("evidence-guide-1", "Evidence: .vtestreport");
  testStepPass("evidence-guide-2", "Evidence: object risk snapshot");
  testStepPass("evidence-guide-3", "Evidence: TTC trace");

  // - object_input_reflect_max: 100 ms
  // - warning_reflect_max: 150 ms

  testStepFail("oracle-hook", "Draft skeleton only. Connect concrete stimulus/oracle hooks before enabling this testcase.");

  resetValidationHarnessIfNeeded();
}
