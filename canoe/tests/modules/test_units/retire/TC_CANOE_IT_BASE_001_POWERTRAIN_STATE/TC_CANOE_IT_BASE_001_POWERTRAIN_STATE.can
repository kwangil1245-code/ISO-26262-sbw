/*@!Encoding:65001*/
includes
{
  #include "..\\common\\ValidationHarnessTestCommon.cin"
}

variables
{
}

export testcase TC_CANOE_IT_BASE_001_POWERTRAIN_STATE()
{
  if (!resetValidationHarnessIfNeeded())
  {
    return;
  }

  if (!launchScenarioAndWait(216, 900, 1300))
  {
    return;
  }

  assertIntEq("powertrain-parked-pass", 1, (long)@Test::scenarioResult, "scenarioResult");
  assertIntEq("powertrain-parked-drive-state", 0, (long)@Core::driveStateNorm, "driveStateNorm");
  assertIntEq("powertrain-parked-speed", 0, (long)@Core::vehicleSpeedNorm, "vehicleSpeedNorm");
  assertIntEq("powertrain-parked-level", 0, (long)@Core::selectedAlertLevel, "selectedAlertLevel");

  if (!resetValidationHarnessIfNeeded())
  {
    return;
  }

  if (!launchScenarioAndWait(217, 900, 1300))
  {
    return;
  }

  assertIntEq("powertrain-drive-pass", 1, (long)@Test::scenarioResult, "scenarioResult");
  assertIntEq("powertrain-drive-state", 3, (long)@Core::driveStateNorm, "driveStateNorm");
  assertIntEq("powertrain-drive-speed", 55, (long)@Core::vehicleSpeedNorm, "vehicleSpeedNorm");
  assertIntEq("powertrain-drive-level", 0, (long)@Core::selectedAlertLevel, "selectedAlertLevel");

  resetValidationHarnessIfNeeded();
}