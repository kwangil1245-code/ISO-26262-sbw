/*@!Encoding:65001*/
includes
{
  #include "..\\common\\ValidationHarnessTestCommon.cin"
}

variables
{
}

export testcase TC_CANOE_IT_V2_FAILSAFE_001_CGW()
{
  if (!resetValidationHarnessIfNeeded())
  {
    return;
  }

  @Test::scenarioCommand = 18;
  if (!waitForScenarioAck(18, 1500))
  {
    return;
  }

  if (!waitForBaseResult(18, 2000))
  {
    return;
  }

  TestWaitForTimeout(200);

  assertIntEq("scenario-pass", 1, (long)@Test::scenarioResult, "scenarioResult");
  assertIntEq("base-scenario-id", 18, (long)@Test::baseScenarioId, "baseScenarioId");
  assertIntEq("base-result", 1, (long)@Test::baseScenarioResult, "baseScenarioResult");
  assertIntMin("fail-safe-mode", 1, (long)@Core::failSafeMode, "failSafeMode");
  assertIntEq("decel-assist", 0, (long)@Core::decelAssistReq, "decelAssistReq");
  assertIntMin("alert-level", 6, (long)@Core::selectedAlertLevel, "selectedAlertLevel");
  assertIntEq("alert-type", 1, (long)@Core::selectedAlertType, "selectedAlertType");
  assertIntMin("cluster-code", 100, (long)@Cluster::warningTextCode, "warningTextCode");

  resetValidationHarnessIfNeeded();
}
