/*@!Encoding:65001*/
includes
{
  #include "..\common\ValidationHarnessTestCommon.cin"
}

variables
{
}

/*
  This asset fixes the system-level stimulus contract for the police external
  transport path, but the final 100ms periodicity verdict must be closed by
  Ethernet trace evidence rather than CAPL-only oracle values.
*/
export testcase TC_CANOE_ST_018_POLICE_TX_PERIOD()
{
  testStepPass("doc-trace", "ST_018 - 경찰 긴급 이벤트 발생 시 Ethernet 경로의 외부 송신 메시지가 정의된 `100ms` 주기로 연속 관찰되는지 확인한다.");
  testStepPass("closeout-smoke", "Closeout smoke: representative input reflection and testcase verdict drive the final ID judgment.");
  if (!resetValidationHarnessIfNeeded())
  {
    return;
  }

  if (!launchScenarioAndWait(4, 700, 1200))
  {
    return;
  }

if (!waitForV2xIngressState(1, 1, 12, 11, 1500))
  {
    resetValidationHarnessIfNeeded();
    return;
  }

  if (!waitForObservedSelectedAlertState(6, 1, 800))
  {
    resetValidationHarnessIfNeeded();
    return;
  }
  assertIntEq("eth-police-level", 6, (long)@Test::obsSelectedAlertLevel, "ethSelectedAlertLevel");
  assertIntEq("eth-police-type", 1, (long)@Test::obsSelectedAlertType, "ethSelectedAlertType");
  assertIntEq("eth-police-alert-state", 1, (long)@V2X::alertState, "alertState");
  assertIntEq("eth-police-type-source", 1, (long)@V2X::emergencyType, "emergencyType");

  /*
    Final verdict closure for ST_018:
    - Ethernet trace must show the police external TX path at 100ms cadence
    - CAPL assertions here only confirm scenario contract and alert activation
  */

  testStepPass("doc-pass", "PASS - ST_018 - 경찰 긴급 이벤트 발생 시 Ethernet 경로의 외부 송신 메시지가 정의된 `100ms` 주기로 연속 관찰되는지 확인한다.");
  resetValidationHarnessIfNeeded();
}