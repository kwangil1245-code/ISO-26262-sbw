/*@!Encoding:65001*/
includes
{
  #include "..\common\ValidationHarnessTestCommon.cin"
}

variables
{
}

export testcase TC_CANOE_IT_016_DRIVE_MODE_SENSITIVITY()
{
  testStepPass("doc-trace", "IT_016 - 주행모드 기반 경보 민감도 반영 통합 검증");
  testStepPass("closeout-smoke", "Closeout smoke: representative input reflection and testcase verdict drive the final ID judgment.");
  if (!resetValidationHarnessIfNeeded())
  {
    return;
  }

  if (!launchScenarioAndWait(236, 900, 1300))
  {
    return;
  }

  if (!waitForCoreSelectedAlertState(4, 3, 800) ||
      !waitForCoreSportMode(1, 800))
  {
    resetValidationHarnessIfNeeded();
    return;
  }

  assertIntEq("drive-mode-sport-level", 4, getCanonicalSelectedAlertLevel(), "selectedAlertLevel");
  assertIntEq("drive-mode-sport-type", 3, getCanonicalSelectedAlertType(), "selectedAlertType");
  assertIntEq("drive-mode-sport-flag", 1, (long)@CoreState::sportMode, "sportMode");

  testStepPass("doc-pass", "PASS - IT_016 - 주행모드 기반 경보 민감도 반영 통합 검증");
  resetValidationHarnessIfNeeded();
}