/*@!Encoding:65001*/
includes
{
  #include "..\\common\\ValidationHarnessTestCommon.cin"
}

variables
{
}

export testcase TC_CANOE_UT_CORE_009_NAV_CTX_MGR()
{
  testStepPass("doc-trace", "UT_009 - 구간, 방향, 거리, 제한속도 정보를 받아 주행 맥락을 계산");
  testStepPass("closeout-smoke", "Closeout smoke: representative input reflection and testcase verdict drive the final ID judgment.");
  if (!resetValidationHarnessIfNeeded())
  {
    return;
  }

  if (!launchScenarioAndWait(2, 800, 1300))
  {
    return;
  }
  if (!waitForNavContextState(1, 30, 800))
  {
    resetValidationHarnessIfNeeded();
    return;
  }
  assertIntEq("nav-school-zone", 1, (long)@Core::baseZoneContext, "baseZoneContext");
  assertIntEq("nav-school-limit", 30, (long)@Core::speedLimitNorm, "speedLimitNorm");

  if (!resetValidationHarnessIfNeeded())
  {
    return;
  }
  if (!launchScenarioAndWait(3, 800, 1300))
  {
    return;
  }
  if (!waitForNavContextState(2, -1, 800))
  {
    resetValidationHarnessIfNeeded();
    return;
  }
  assertIntEq("nav-highway-zone", 2, (long)@Core::baseZoneContext, "baseZoneContext");

  if (!resetValidationHarnessIfNeeded())
  {
    return;
  }
  if (!launchScenarioAndWait(7, 800, 1300))
  {
    return;
  }
  if (!waitForNavContextState(3, -1, 800))
  {
    resetValidationHarnessIfNeeded();
    return;
  }
  assertIntEq("nav-guide-left-zone", 3, (long)@Core::baseZoneContext, "baseZoneContext");

  if (!resetValidationHarnessIfNeeded())
  {
    return;
  }
  if (!launchScenarioAndWait(8, 800, 1300))
  {
    return;
  }
  if (!waitForNavContextState(4, -1, 800))
  {
    resetValidationHarnessIfNeeded();
    return;
  }
  assertIntEq("nav-guide-right-zone", 4, (long)@Core::baseZoneContext, "baseZoneContext");

  testStepPass("doc-pass", "PASS - UT_009 - 구간, 방향, 거리, 제한속도 정보를 받아 주행 맥락을 계산");
  resetValidationHarnessIfNeeded();
}