/*@!Encoding:65001*/
includes
{
  #include "..\\common\\ValidationHarnessTestCommon.cin"
}

variables
{
}

export testcase TC_CANOE_UT_CORE_012_BODY_GW_ROUTE()
{
  testStepPass("doc-trace", "UT_012 - 경고 결과를 50ms 주기로 앰비언트 출력 경로에 전달");
  testStepPass("closeout-smoke", "Closeout smoke: representative input reflection and testcase verdict drive the final ID judgment.");
  if (!resetValidationHarnessIfNeeded())
  {
    return;
  }

  if (!launchScenarioAndWait(208, 800, 1300))
  {
    return;
  }
  if (!waitForNavContextState(1, 30, 800) ||
      !waitForAmbientStateMinLevel(3, 3, 3, 5, 800))
  {
    resetValidationHarnessIfNeeded();
    return;
  }
  assertIntEq("body-gw-school-route", 1, (long)@CoreState::routingPolicy, "routingPolicy");
  assertIntEq("body-gw-school-path", 0, (long)@CoreState::warningPathStatus, "warningPathStatus");
  assertIntEq("body-gw-school-color", 3, (long)@Body::ambientColor, "ambientColor");
  assertIntEq("body-gw-school-pattern", 5, (long)@Body::ambientPattern, "ambientPattern");

  if (!resetValidationHarnessIfNeeded())
  {
    return;
  }
  if (!launchScenarioAndWait(4, 800, 1300))
  {
    return;
  }
if (!waitForV2xIngressState(1, 1, 12, 11, 1500) ||
      !waitForCoreSelectedAlertState(6, 1, 800))
  {
    resetValidationHarnessIfNeeded();
    return;
  }
  assertIntEq("body-gw-emergency-route", 2, (long)@CoreState::routingPolicy, "routingPolicy");
  assertIntEq("body-gw-emergency-path", 0, (long)@CoreState::warningPathStatus, "warningPathStatus");
  assertIntEq("body-gw-emergency-color", 6, (long)@Body::ambientColor, "ambientColor");
  assertIntEq("body-gw-emergency-pattern", 6, (long)@Body::ambientPattern, "ambientPattern");

  testStepPass("doc-pass", "PASS - UT_012 - 경고 결과를 50ms 주기로 앰비언트 출력 경로에 전달");
  resetValidationHarnessIfNeeded();
}