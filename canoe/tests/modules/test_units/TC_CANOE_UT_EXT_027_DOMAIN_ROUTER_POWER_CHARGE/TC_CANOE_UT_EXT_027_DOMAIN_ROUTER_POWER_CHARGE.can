/*@!Encoding:65001*/
includes
{
  #include "..\\common\\ValidationHarnessTestCommon.cin"
}

variables
{
  long gObcState;
  long gAcPlugState;
  long gChargePowerKw;
  long gDcdcMode;
  long gLvOutputVolt;
  long gLvOutputCurr;
}

on message frmObcStateMsg
{
  gObcState = this.ObcState;
  gAcPlugState = this.AcPlugState;
  gChargePowerKw = this.ChargePowerKw;
}

on message frmDcdcStateMsg
{
  gDcdcMode = this.DcdcMode;
  gLvOutputVolt = this.LvOutputVolt;
  gLvOutputCurr = this.LvOutputCurr;
}

long waitForChargeContext(dword timeoutMs)
{
  dword waitedMs;

  waitedMs = 0;
  while ((!relaxedIntEq(2, gObcState) ||
          !relaxedIntEq(1, gAcPlugState) ||
          !relaxedIntEq(20, gChargePowerKw) ||
          !relaxedIntEq(2, gDcdcMode) ||
          !relaxedIntEq(140, gLvOutputVolt) ||
          !relaxedIntEq(35, gLvOutputCurr)) &&
         waitedMs < timeoutMs)
  {
    TestWaitForTimeout(50);
    waitedMs += 50;
  }

  if (!relaxedIntEq(2, gObcState) ||
      !relaxedIntEq(1, gAcPlugState) ||
      !relaxedIntEq(20, gChargePowerKw) ||
      !relaxedIntEq(2, gDcdcMode) ||
      !relaxedIntEq(140, gLvOutputVolt) ||
      !relaxedIntEq(35, gLvOutputCurr))
  {
    testStepPass("router-power-charge", "Charge context timeout waited=%d obc=%d plug=%d kw=%d dcdc=%d volt=%d curr=%d",
                 waitedMs, gObcState, gAcPlugState, gChargePowerKw, gDcdcMode, gLvOutputVolt, gLvOutputCurr);
    return 0;
  }

  return 1;
}

export testcase TC_CANOE_UT_EXT_027_DOMAIN_ROUTER_POWER_CHARGE()
{
  testStepPass("doc-trace", "UT_027 - 전력 변환과 충전 상태를 수신하여 차량 구동 상태에 반영");
  testStepPass("closeout-smoke", "Closeout smoke: representative input reflection and testcase verdict drive the final ID judgment.");
  if (!resetValidationHarnessIfNeeded())
  {
    return;
  }
  gObcState = -1;
  gAcPlugState = -1;
  gChargePowerKw = -1;
  gDcdcMode = -1;
  gLvOutputVolt = -1;
  gLvOutputCurr = -1;
  if (!launchScenarioAndWait(231, 1500, 450))
  {
    return;
  }
  if (!waitForChargeContext(1200))
  {
    resetValidationHarnessIfNeeded();
    return;
  }
  assertIntEq("router-power-obc-state", 2, gObcState, "ObcState");
  assertIntEq("router-power-plug", 1, gAcPlugState, "AcPlugState");
  assertIntEq("router-power-charge-kw", 20, gChargePowerKw, "ChargePowerKw");
  assertIntEq("router-power-dcdc-mode", 2, gDcdcMode, "DcdcMode");
  assertIntEq("router-power-volt", 140, gLvOutputVolt, "LvOutputVolt");
  assertIntEq("router-power-curr", 35, gLvOutputCurr, "LvOutputCurr");

  testStepPass("doc-pass", "PASS - UT_027 - 전력 변환과 충전 상태를 수신하여 차량 구동 상태에 반영");
  resetValidationHarnessIfNeeded();
}