/*@!Encoding:65001*/
includes
{
  #include "..\\common\\ValidationHarnessTestCommon.cin"
}

variables
{
}

export testcase TC_CANOE_IT_CORE_002_SCHOOLZONE_PATH()
{
  testStepPass("doc-trace", "IT_002 - 구간 정보와 제한속도 변화에 따른 기본 및 스쿨존 경고 판단 통합 검증");
  testStepPass("closeout-smoke", "Closeout smoke: representative input reflection and testcase verdict drive the final ID judgment.");
  if (!resetValidationHarnessIfNeeded())
  {
    return;
  }

  if (!launchScenarioAndWait(2, 700, 1200))
  {
    return;
  }

  if (!waitForNavContextState(1, 30, 800) ||
      !waitForAmbientStateMinLevel(3, 3, 3, 5, 800))
  {
    resetValidationHarnessIfNeeded();
    return;
  }

  assertIntMin("selected-alert-level", 3, getCanonicalSelectedAlertLevel(), "selectedAlertLevel");
  assertIntEq("selected-alert-type", 3, getCanonicalSelectedAlertType(), "selectedAlertType");
  assertIntEq("ambient-color", 3, (long)@Body::ambientColor, "ambientColor");
  assertIntEq("ambient-pattern", 5, (long)@Body::ambientPattern, "ambientPattern");

  testStepPass("doc-pass", "PASS - IT_002 - 구간 정보와 제한속도 변화에 따른 기본 및 스쿨존 경고 판단 통합 검증");
  resetValidationHarnessIfNeeded();
}