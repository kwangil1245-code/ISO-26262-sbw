/*@!Encoding:65001*/
includes
{
  #include "..\\common\\ValidationHarnessTestCommon.cin"
}

variables
{
}

export testcase TC_CANOE_ST_V2_016_POLICE_TIEBREAK()
{
  testStepPass("doc-trace", "ST_016 - 동일 등급의 경찰 긴급 알림이 복수 수신될 때 ETA가 더 짧은 경고가 우선 선택되고 동일 ETA에서는 SourceID 규칙이 적용되는지 확인한다.");
  testStepPass("closeout-smoke", "Closeout smoke: representative input reflection and testcase verdict drive the final ID judgment.");
  if (!resetValidationHarnessIfNeeded())
  {
    return;
  }

  if (!launchScenarioAndWait(10, 700, 1200))
  {
    return;
  }

if (!waitForV2xIngressState(1, 1, 10, 5, 1500))
  {
    resetValidationHarnessIfNeeded();
    return;
  }

  assertIntEq("police-tiebreak-eta", 10, (long)@V2X::eta, "eta");
  assertIntEq("police-tiebreak-source", 5, (long)@V2X::sourceId, "sourceId");
  if (!waitForObservedSelectedAlertState(6, 1, 800))
  {
    resetValidationHarnessIfNeeded();
    return;
  }
  assertIntEq("police-tiebreak-level", 6, (long)@Test::obsSelectedAlertLevel, "ethSelectedAlertLevel");
  assertIntEq("police-tiebreak-alert-type", 1, (long)@Test::obsSelectedAlertType, "ethSelectedAlertType");

  testStepPass("doc-pass", "PASS - ST_016 - 동일 등급의 경찰 긴급 알림이 복수 수신될 때 ETA가 더 짧은 경고가 우선 선택되고 동일 ETA에서는 SourceID 규칙이 적용되는지 확인한다.");
  resetValidationHarnessIfNeeded();
}