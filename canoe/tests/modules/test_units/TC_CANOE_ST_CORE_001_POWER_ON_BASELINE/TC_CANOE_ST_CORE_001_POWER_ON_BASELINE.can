/*@!Encoding:65001*/
includes
{
  #include "..\\common\\ValidationHarnessTestCommon.cin"
}

variables
{
}

export testcase TC_CANOE_ST_CORE_001_POWER_ON_BASELINE()
{
  testStepPass("doc-trace", "ST_001 - 전원 ON 후 기본 표시와 경고 상태가 초기화되고 불필요한 경고 없이 주행 준비 상태로 진입하는지 확인한다.");
  testStepPass("closeout-smoke", "Closeout smoke: representative input reflection and testcase verdict drive the final ID judgment.");
  if (!resetValidationHarnessIfNeeded())
  {
    return;
  }

  if (!launchScenarioAndWait(1, 700, 1000))
  {
    return;
  }
  if (!waitForCoreSelectedAlertState(0, 0, 800) ||
      !waitForCoreDriveState(-1, -1, 0, 800) ||
      !waitForStableWarningRender(0, -1, 800))
  {
    resetValidationHarnessIfNeeded();
    return;
  }

  assertIntEq("st001-level", 0, getCanonicalSelectedAlertLevel(), "selectedAlertLevel");
  assertIntEq("st001-type", 0, getCanonicalSelectedAlertType(), "selectedAlertType");
  assertIntEq("st001-code", 0, (long)@Cluster::warningTextCode, "warningTextCode");
  assertIntEq("st001-failsafe", 0, (long)@Core::failSafeMode, "failSafeMode");

  testStepPass("doc-pass", "PASS - ST_001 - 전원 ON 후 기본 표시와 경고 상태가 초기화되고 불필요한 경고 없이 주행 준비 상태로 진입하는지 확인한다.");
  resetValidationHarnessIfNeeded();
}