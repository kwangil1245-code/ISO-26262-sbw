/*@!Encoding:65001*/
includes
{
  #include "..\\common\\ValidationHarnessTestCommon.cin"
}

variables
{
}

export testcase TC_CANOE_IT_V2_006_ARBITRATION()
{
  testStepPass("doc-trace", "IT_006 - 긴급 경고, 구간 경고, 긴급차량 유형 간 우선순위 통합 검증");
  testStepPass("closeout-smoke", "Closeout smoke: representative input reflection and testcase verdict drive the final ID judgment.");
  if (!resetValidationHarnessIfNeeded())
  {
    return;
  }

  if (!launchScenarioAndWait(9, 700, 1200))
  {
    return;
  }

if (!waitForV2xIngressState(1, 1, 10, 99, 1500))
  {
    resetValidationHarnessIfNeeded();
    return;
  }

  assertIntEq("eta-priority-eta", 10, (long)@V2X::eta, "eta");
  assertIntEq("eta-priority-source", 99, (long)@V2X::sourceId, "sourceId");
  if (!waitForObservedSelectedAlertState(6, 1, 800))
  {
    resetValidationHarnessIfNeeded();
    return;
  }
  assertIntEq("eta-priority-level", 6, (long)@Test::obsSelectedAlertLevel, "ethSelectedAlertLevel");

  if (!resetValidationHarnessIfNeeded())
  {
    return;
  }

  if (!launchScenarioAndWait(10, 700, 1200))
  {
    return;
  }

if (!waitForV2xIngressState(1, 1, 10, 5, 1500))
  {
    resetValidationHarnessIfNeeded();
    return;
  }

  assertIntEq("source-tiebreak-eta", 10, (long)@V2X::eta, "eta");
  assertIntEq("source-tiebreak-source", 5, (long)@V2X::sourceId, "sourceId");
  if (!waitForObservedSelectedAlertState(6, 1, 800))
  {
    resetValidationHarnessIfNeeded();
    return;
  }
  assertIntEq("source-tiebreak-level", 6, (long)@Test::obsSelectedAlertLevel, "ethSelectedAlertLevel");

  if (!resetValidationHarnessIfNeeded())
  {
    return;
  }

  if (!launchScenarioAndWait(11, 800, 1300))
  {
    return;
  }

  if (!waitForObservedSelectedAlertState(6, 1, 800))
  {
    resetValidationHarnessIfNeeded();
    return;
  }
  assertIntEq("emergency-over-nav-level", 6, (long)@Test::obsSelectedAlertLevel, "ethSelectedAlertLevel");
  assertIntEq("emergency-over-nav-type", 1, (long)@Test::obsSelectedAlertType, "ethSelectedAlertType");
  assertIntMin("arbitration-snapshot", 1, (long)@Test::baseTraceSnapshotId, "baseTraceSnapshotId");

  if (!resetValidationHarnessIfNeeded())
  {
    return;
  }

  if (!launchScenarioAndWait(212, 700, 1200))
  {
    return;
  }

if (!waitForV2xIngressState(1, 2, 8, 22, 1500))
  {
    resetValidationHarnessIfNeeded();
    return;
  }

  assertIntEq("ambulance-priority-type", 2, (long)@V2X::emergencyType, "emergencyType");
  if (!waitForObservedSelectedAlertState(7, 2, 800))
  {
    resetValidationHarnessIfNeeded();
    return;
  }
  assertIntEq("ambulance-priority-level", 7, (long)@Test::obsSelectedAlertLevel, "ethSelectedAlertLevel");
  assertIntEq("ambulance-priority-alert-type", 2, (long)@Test::obsSelectedAlertType, "ethSelectedAlertType");
  assertIntEq("ambulance-priority-code", deriveExpectedEmergencyWarningCode(2, 2, 8, 20), (long)@Cluster::warningTextCode, "warningTextCode");

  testStepPass("doc-pass", "PASS - IT_006 - 긴급 경고, 구간 경고, 긴급차량 유형 간 우선순위 통합 검증");
  resetValidationHarnessIfNeeded();
}