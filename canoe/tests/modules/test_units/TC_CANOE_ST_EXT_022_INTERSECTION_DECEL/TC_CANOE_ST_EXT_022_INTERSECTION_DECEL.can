/*@!Encoding:65001*/
includes
{
  #include "..\\common\\ValidationHarnessTestCommon.cin"
}

variables
{
}

export testcase TC_CANOE_ST_EXT_022_INTERSECTION_DECEL()
{
  testStepPass("doc-trace", "ST_022 - 교차로에서 긴급차량 접근과 TTC 충돌 위험이 함께 높아질 때 자동 감속 보조 요청과 경고 출력이 함께 활성되는지 확인한다. (SIL Scenario 213)");
  testStepPass("closeout-smoke", "Closeout smoke: representative input reflection and testcase verdict drive the final ID judgment.");
  if (!resetValidationHarnessIfNeeded()) { return; }
  if (!launchScenarioAndWait(213, 800, 1300)) { return; }
  if (!waitForObservedDecelState(1, 1, 0, 1500) ||
      !waitForObservedIntersectionConflict(1500) ||
      !waitForObservedSelectedAlertState(7, 2, 1500)) { resetValidationHarnessIfNeeded(); return; }
  assertIntEq("st-intersection-flag", 1, (long)@Test::obsIntersectionConflictFlag, "ethIntersectionConflictFlag");
  assertIntEq("st-intersection-decision", 1, (long)@Test::obsDecelDecisionReq, "ethDecelDecisionReq");
  assertIntEq("st-intersection-decel-req", 1, (long)@Test::obsDecelAssistReq, "ethDecelAssistReq");
  assertIntEq("st-intersection-gate-clear", 0, (long)@Test::obsDecelGateReason, "ethDecelGateReason");
  assertIntEq("st-intersection-level", 7, (long)@Test::obsSelectedAlertLevel, "ethSelectedAlertLevel");
  assertIntEq("st-intersection-type", 2, (long)@Test::obsSelectedAlertType, "ethSelectedAlertType");
  testStepPass("doc-pass", "PASS - ST_022 - 교차로에서 긴급차량 접근과 TTC 충돌 위험이 함께 높아질 때 자동 감속 보조 요청과 경고 출력이 함께 활성되는지 확인한다. (SIL Scenario 213)");
  resetValidationHarnessIfNeeded();
}