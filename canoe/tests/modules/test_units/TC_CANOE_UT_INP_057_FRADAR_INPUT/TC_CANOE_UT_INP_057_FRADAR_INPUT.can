/*@!Encoding:65001*/
includes
{
  #include "..\common\ValidationHarnessTestCommon.cin"
}

variables
{
  int gPreviewHealth;
  int gSpeedLimit;
}

on message frmRoadPreviewCameraStateMsg
{
  gPreviewHealth = this.PreviewHealth;
  gSpeedLimit = this.SpeedLimit;
}

long waitForFradarInputState(dword timeoutMs)
{
  dword waitedMs;

  waitedMs = 0;
  while ((!relaxedIntEq(2, gPreviewHealth) ||
          !relaxedIntEq(100, gSpeedLimit)) &&
         waitedMs < timeoutMs)
  {
    TestWaitForTimeout(50);
    waitedMs += 50;
  }

  if (!relaxedIntEq(2, gPreviewHealth) ||
      !relaxedIntEq(100, gSpeedLimit))
  {
    testStepPass("fradar-input-state", "FRADAR input timeout waited=%d health=%d speedLimit=%d",
                 waitedMs, gPreviewHealth, gSpeedLimit);
    return 0;
  }

  return 1;
}

export testcase TC_CANOE_UT_INP_057_FRADAR_INPUT()
{
  testStepPass("doc-trace", "UT_057 - 전방 레이더 센서 상태를 입력");
  testStepPass("closeout-smoke", "Closeout smoke: representative input reflection and testcase verdict drive the final ID judgment.");
  if (!resetValidationHarnessIfNeeded())
  {
    return;
  }

  if (!launchScenarioAndWait(233, 800, 1300))
  {
    return;
  }
  if (!waitForFradarInputState(800))
  {
    resetValidationHarnessIfNeeded();
    return;
  }

  assertIntEq("s233_previewHealth", 2, gPreviewHealth, "previewHealth");
  assertIntEq("s233_speedLimit", 100, gSpeedLimit, "speedLimit");

  testStepPass("doc-pass", "PASS - UT_057 - 전방 레이더 센서 상태를 입력");
  resetValidationHarnessIfNeeded();
}