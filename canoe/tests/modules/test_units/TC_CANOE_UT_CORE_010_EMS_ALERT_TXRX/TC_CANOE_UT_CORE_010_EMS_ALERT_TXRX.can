/*@!Encoding:65001*/
includes
{
  #include "..\\common\\ValidationHarnessTestCommon.cin"
}

variables
{
}

/*
  UT_010
  Emergency transport lifecycle unit contract.
  Frame-period closure remains trace-gated, but activation / receive / clear behavior
  is fixed here as executable CAPL assertions.
*/
export testcase TC_CANOE_UT_CORE_010_EMS_ALERT_TXRX()
{
  testStepPass("doc-trace", "UT_010 - 경찰, 구급 긴급 이벤트의 송신, 수신, 해제, 1000ms 타임아웃 동작을 검증");
  testStepPass("closeout-smoke", "Closeout smoke: representative input reflection and testcase verdict drive the final ID judgment.");
  if (!resetValidationHarnessIfNeeded())
  {
    return;
  }

  if (!launchScenarioAndWait(4, 700, 1200))
  {
    return;
  }

if (!waitForV2xIngressState(1, 1, 12, 11, 1500) ||
      !waitForCoreSelectedAlertState(6, -1, 800))
  {
    resetValidationHarnessIfNeeded();
    return;
  }

  assertIntEq("ems-police-alert-state", 1, (long)@V2X::alertState, "alertState");
  assertIntEq("ems-police-type", 1, (long)@V2X::emergencyType, "emergencyType");
  assertIntEq("ems-police-eta", 12, (long)@V2X::eta, "eta");
  assertIntEq("ems-police-source", 11, (long)@V2X::sourceId, "sourceId");
  assertIntEq("ems-police-level", 6, getCanonicalSelectedAlertLevel(), "selectedAlertLevel");

  if (!resetValidationHarnessIfNeeded())
  {
    return;
  }

  if (!launchScenarioAndWait(5, 700, 1200))
  {
    return;
  }

if (!waitForV2xIngressState(1, 2, 8, 22, 1500) ||
      !waitForCoreSelectedAlertState(7, -1, 800))
  {
    resetValidationHarnessIfNeeded();
    return;
  }

  assertIntEq("ems-ambulance-alert-state", 1, (long)@V2X::alertState, "alertState");
  assertIntEq("ems-ambulance-type", 2, (long)@V2X::emergencyType, "emergencyType");
  assertIntEq("ems-ambulance-eta", 8, (long)@V2X::eta, "eta");
  assertIntEq("ems-ambulance-source", 22, (long)@V2X::sourceId, "sourceId");
  assertIntEq("ems-ambulance-level", 7, getCanonicalSelectedAlertLevel(), "selectedAlertLevel");

  if (!resetValidationHarnessIfNeeded())
  {
    return;
  }

  if (!launchScenarioAndWait(6, 1800, 2300))
  {
    return;
  }

if (!waitForV2xIngressState(0, 0, 0, 0, 1500) ||
      !waitForCoreSelectedAlertState(0, 0, 800))
  {
    resetValidationHarnessIfNeeded();
    return;
  }

  assertIntEq("ems-timeout-clear", 1, (long)@Core::timeoutClear, "timeoutClear");
  assertIntEq("ems-timeout-level", 0, getCanonicalSelectedAlertLevel(), "selectedAlertLevel");
  assertIntEq("ems-timeout-code", 0, (long)@Cluster::warningTextCode, "warningTextCode");

  testStepPass("doc-pass", "PASS - UT_010 - 경찰, 구급 긴급 이벤트의 송신, 수신, 해제, 1000ms 타임아웃 동작을 검증");
  resetValidationHarnessIfNeeded();
}