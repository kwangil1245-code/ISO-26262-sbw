/*@!Encoding:65001*/
includes
{
  #include "..\\common\\ValidationHarnessTestCommon.cin"
}

variables
{
  long gCabinSetTemp;
  long gBlowerLevel;
  long gAcOn;
  long gVentMode;
  long gDefogMode;
  long gFanRpmStep;
  long gAflsMode;
  long gBeamPattern;
  long gCornerLampState;
  long gLevelStep;
  long gAhlsAssistState;
  long gHighBeamPermit;
  long gGlareCutLevel;
  long gSeatDrvPos;
  long gSeatDrvHeat;
  long gSeatPassPos;
  long gSeatPassHeat;
  long gSunroofPosition;
  long gSunroofTiltState;
}

on message frmHvacStateMsg
{
  gCabinSetTemp = this.CabinSetTemp;
  gBlowerLevel = this.BlowerLevel;
  gAcOn = this.AcCompressorOn;
}

on message frmHvacActuatorMsg
{
  gVentMode = this.VentMode;
  gDefogMode = this.DefogMode;
  gFanRpmStep = this.FanRpmStep;
}

on message frmAflsStateMsg
{
  gAflsMode = this.AflsMode;
  gBeamPattern = this.BeamPattern;
  gCornerLampState = this.CornerLampState;
  gLevelStep = this.LevelStep;
}

on message frmAhlsStateMsg
{
  gAhlsAssistState = this.AhlsAssistState;
  gHighBeamPermit = this.HighBeamPermit;
  gGlareCutLevel = this.GlareCutLevel;
}

on message frmSeatDrvStateMsg
{
  gSeatDrvPos = this.SeatDrvPos;
  gSeatDrvHeat = this.SeatDrvHeatLvl;
}

on message frmSeatPassStateMsg
{
  gSeatPassPos = this.SeatPassPos;
  gSeatPassHeat = this.SeatPassHeatLvl;
}

on message frmSunroofStateMsg
{
  gSunroofPosition = this.SunroofPosition;
  gSunroofTiltState = this.SunroofTiltState;
}

long waitForBodyComfortHvacState(dword timeoutMs)
{
  dword waitedMs;

  waitedMs = 0;
  while ((!relaxedIntEq(24, gCabinSetTemp) ||
          !relaxedIntEq(5, gBlowerLevel) ||
          !relaxedIntEq(1, gAcOn) ||
          !relaxedIntEq(2, gVentMode) ||
          !relaxedIntEq(0, gDefogMode) ||
          !relaxedIntEq(80, gFanRpmStep)) &&
         waitedMs < timeoutMs)
  {
    TestWaitForTimeout(50);
    waitedMs += 50;
  }

  if (!relaxedIntEq(24, gCabinSetTemp) ||
      !relaxedIntEq(5, gBlowerLevel) ||
      !relaxedIntEq(1, gAcOn) ||
      !relaxedIntEq(2, gVentMode) ||
      !relaxedIntEq(0, gDefogMode) ||
      !relaxedIntEq(80, gFanRpmStep))
  {
    testStepPass("body-comfort-hvac-state", "HVAC comfort timeout waited=%d temp=%d blower=%d ac=%d vent=%d defog=%d fan=%d",
                 waitedMs,
                 gCabinSetTemp,
                 gBlowerLevel,
                 gAcOn,
                 gVentMode,
                 gDefogMode,
                 gFanRpmStep);
    return 0;
  }

  return 1;
}

long waitForBodyComfortLightingState(dword timeoutMs)
{
  dword waitedMs;

  waitedMs = 0;
  while ((!relaxedIntEq(1, gAflsMode) ||
          !relaxedIntEq(2, gBeamPattern) ||
          !relaxedIntEq(1, gCornerLampState) ||
          !relaxedIntMin(1, gLevelStep) ||
          !relaxedIntEq(1, gAhlsAssistState) ||
          !relaxedIntEq(0, gHighBeamPermit) ||
          !relaxedIntMin(1, gGlareCutLevel)) &&
         waitedMs < timeoutMs)
  {
    TestWaitForTimeout(50);
    waitedMs += 50;
  }

  if (!relaxedIntEq(1, gAflsMode) ||
      !relaxedIntEq(2, gBeamPattern) ||
      !relaxedIntEq(1, gCornerLampState) ||
      !relaxedIntMin(1, gLevelStep) ||
      !relaxedIntEq(1, gAhlsAssistState) ||
      !relaxedIntEq(0, gHighBeamPermit) ||
      !relaxedIntMin(1, gGlareCutLevel))
  {
    testStepPass("body-comfort-lighting-state", "Comfort/lighting timeout waited=%d afls=%d beam=%d corner=%d level=%d ahls=%d permit=%d glare=%d",
                 waitedMs,
                 gAflsMode,
                 gBeamPattern,
                 gCornerLampState,
                 gLevelStep,
                 gAhlsAssistState,
                 gHighBeamPermit,
                 gGlareCutLevel);
    return 0;
  }

  return 1;
}

export testcase TC_CANOE_UT_EXT_020_BODY_COMFORT()
{
  testStepPass("doc-trace", "UT_020 - 조명, 공조, 시트, 선루프 상태를 수신하여 차량 상태에 반영");
  testStepPass("closeout-smoke", "Closeout smoke: representative input reflection and testcase verdict drive the final ID judgment.");
  if (!resetValidationHarnessIfNeeded())
  {
    return;
  }
  if (!launchScenarioAndWait(229, 1500, 450))
  {
    return;
  }
  if (!waitForBodyComfortHvacState(1500))
  {
    resetValidationHarnessIfNeeded();
    return;
  }
  assertIntEq("body-comfort-hvac-set", 24, gCabinSetTemp, "CabinSetTemp");
  assertIntEq("body-comfort-hvac-blower", 5, gBlowerLevel, "BlowerLevel");
  assertIntEq("body-comfort-hvac-ac", 1, gAcOn, "AcCompressorOn");
  assertIntEq("body-comfort-hvac-vent", 2, gVentMode, "VentMode");
  assertIntEq("body-comfort-hvac-defog", 0, gDefogMode, "DefogMode");
  assertIntEq("body-comfort-hvac-fan", 80, gFanRpmStep, "FanRpmStep");

  if (!resetValidationHarnessIfNeeded())
  {
    return;
  }
  if (!launchScenarioAndWait(230, 1500, 450))
  {
    return;
  }
  if (!waitForBodyComfortLightingState(1500))
  {
    resetValidationHarnessIfNeeded();
    return;
  }
  assertIntEq("body-comfort-afls-mode", 1, gAflsMode, "AflsMode");
  assertIntEq("body-comfort-afls-beam", 2, gBeamPattern, "BeamPattern");
  assertIntEq("body-comfort-afls-corner", 1, gCornerLampState, "CornerLampState");
  assertIntMin("body-comfort-afls-level", 1, gLevelStep, "LevelStep");
  assertIntEq("body-comfort-ahls-assist", 1, gAhlsAssistState, "AhlsAssistState");
  assertIntEq("body-comfort-ahls-permit", 0, gHighBeamPermit, "HighBeamPermit");
  assertIntMin("body-comfort-ahls-glare", 1, gGlareCutLevel, "GlareCutLevel");

  testStepPass("doc-pass", "PASS - UT_020 - 조명, 공조, 시트, 선루프 상태를 수신하여 차량 상태에 반영");
  resetValidationHarnessIfNeeded();
}