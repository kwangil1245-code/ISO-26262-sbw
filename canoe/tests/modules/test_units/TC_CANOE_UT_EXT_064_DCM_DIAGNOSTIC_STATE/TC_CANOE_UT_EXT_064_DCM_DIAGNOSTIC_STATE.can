/*@!Encoding:65001*/
includes
{
  #include "..\\common\\ValidationHarnessTestCommon.cin"
}

variables
{
}

export testcase TC_CANOE_UT_EXT_064_DCM_DIAGNOSTIC_STATE()
{
  testStepPass("doc-trace", "UT_064 - 진단 제어 상태를 입력하여 진단 요청/응답 요약과 서비스 판단 상태에 반영");
  testStepPass("closeout-smoke", "Closeout smoke: representative input reflection and testcase verdict drive the final ID judgment.");
  // Verify DCM diagnostic state plus request/response observation summary.
  if (!resetValidationHarnessIfNeeded())
  {
    return;
  }

  if (!launchScenarioAndWait(204, 1500, 2100))
  {
    return;
  }

  if (!waitForDiagSemanticState(-1, -1, -1, 4, 2, 1800) ||
      !waitForDiagLastExchange(2, 0x22, 2, 0x7F, 1800))
  {
    resetValidationHarnessIfNeeded();
    return;
  }

  assertIntEq("request-target", 2, (long)@Diag::LastRequestTarget, "LastRequestTarget");
  assertIntEq("last-sid", 0x22, (long)@Diag::LastRequestSid, "LastRequestSid");
  assertIntEq("request-did-high", 0, (long)@Diag::LastRequestDidHigh, "LastRequestDidHigh");
  assertIntEq("request-did-low", 0, (long)@Diag::LastRequestDidLow, "LastRequestDidLow");
  assertIntEq("request-source-bus", 1, (long)@Diag::LastRequestSourceBus, "LastRequestSourceBus");
  assertLongGe("request-counter", (long)@Diag::RequestCounter, 1, "RequestCounter");
  assertLongGe("request-time", (long)@Diag::LastRequestTimeMs, 1, "LastRequestTimeMs");
  assertIntEq("response-kind", 4, (long)@Diag::ResponseKind, "ResponseKind");
  assertIntEq("reason-code", 2, (long)@Diag::ReasonCode, "ReasonCode");
  assertIntEq("response-target", 2, (long)@Diag::LastResponseTarget, "LastResponseTarget");
  assertIntEq("response-code", 0x7F, (long)@Diag::LastResponseCode, "LastResponseCode");
  assertIntEq("response-data0", 2, (long)@Diag::LastResponseData0, "LastResponseData0");
  assertIntEq("response-data1", 4, (long)@Diag::LastResponseData1, "LastResponseData1");
  assertIntEq("response-ok", 0, (long)@Diag::LastResponseOk, "LastResponseOk");
  assertIntEq("response-source-bus", 1, (long)@Diag::LastResponseSourceBus, "LastResponseSourceBus");
  assertLongGe("response-counter", (long)@Diag::ResponseCounter, 1, "ResponseCounter");
  assertLongGe("response-time", (long)@Diag::LastResponseTimeMs, 1, "LastResponseTimeMs");

  testStepPass("doc-pass", "PASS - UT_064 - 진단 제어 상태를 입력하여 진단 요청/응답 요약과 서비스 판단 상태에 반영");
  resetValidationHarnessIfNeeded();
}