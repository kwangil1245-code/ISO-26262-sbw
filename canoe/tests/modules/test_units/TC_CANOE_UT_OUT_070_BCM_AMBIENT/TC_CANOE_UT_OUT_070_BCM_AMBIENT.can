/*@!Encoding:65001*/
includes
{
  #include "..\\common\\ValidationHarnessTestCommon.cin"
}

variables
{
}

export testcase TC_CANOE_UT_OUT_070_BCM_AMBIENT()
{
  testStepPass("doc-trace", "UT_070 - 경고 상태에 따라 앰비언트 모드, 색상, 패턴을 출력");
  testStepPass("closeout-smoke", "Closeout smoke: representative input reflection and testcase verdict drive the final ID judgment.");
  if (!resetValidationHarnessIfNeeded())
  {
    return;
  }

  if (!launchScenarioAndWait(208, 700, 1200))
  {
    return;
  }
  if (!waitForAmbientStateMinLevel(3, 3, 3, 5, 800))
  {
    resetValidationHarnessIfNeeded();
    return;
  }

  assertIntMin("ambient-schoolzone-level", 3, getCanonicalSelectedAlertLevel(), "selectedAlertLevel");
  assertIntEq("ambient-schoolzone-type", 3, getCanonicalSelectedAlertType(), "selectedAlertType");
  assertIntEq("ambient-schoolzone-color", 3, (long)@Body::ambientColor, "ambientColor");
  assertIntEq("ambient-schoolzone-pattern", 5, (long)@Body::ambientPattern, "ambientPattern");

  if (!resetValidationHarnessIfNeeded())
  {
    return;
  }

  if (!launchScenarioAndWait(4, 700, 1200))
  {
    return;
  }
  if (!waitForAmbientState(6, 1, 6, 6, 800))
  {
    resetValidationHarnessIfNeeded();
    return;
  }

  assertIntEq("ambient-emergency-level", 6, getCanonicalSelectedAlertLevel(), "selectedAlertLevel");
  assertIntEq("ambient-emergency-type", 1, getCanonicalSelectedAlertType(), "selectedAlertType");
  assertIntEq("ambient-emergency-color", 6, (long)@Body::ambientColor, "ambientColor");
  assertIntEq("ambient-emergency-pattern", 6, (long)@Body::ambientPattern, "ambientPattern");

  testStepPass("doc-pass", "PASS - UT_070 - 경고 상태에 따라 앰비언트 모드, 색상, 패턴을 출력");
  resetValidationHarnessIfNeeded();
}