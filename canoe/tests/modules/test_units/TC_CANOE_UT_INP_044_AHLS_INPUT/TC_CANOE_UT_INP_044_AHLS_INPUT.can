/*@!Encoding:65001*/
includes
{
  #include "..\common\ValidationHarnessTestCommon.cin"
}

variables
{
  int gAhlsAssistState;
  int gHighBeamPermit;
}

on message frmAhlsStateMsg
{
  gAhlsAssistState = this.AhlsAssistState;
  gHighBeamPermit = this.HighBeamPermit;
}

long waitForAhlsInputState(dword timeoutMs)
{
  dword waitedMs;

  waitedMs = 0;
  while (!relaxedIntEq(1, gAhlsAssistState) &&
         waitedMs < timeoutMs)
  {
    TestWaitForTimeout(50);
    waitedMs += 50;
  }

  if (!relaxedIntEq(1, gAhlsAssistState))
  {
    testStepPass("ahls-input-state", "AHLS input timeout waited=%d assist=%d permit=%d",
                 waitedMs,
                 gAhlsAssistState,
                 gHighBeamPermit);
    return 0;
  }

  return 1;
}

export testcase TC_CANOE_UT_INP_044_AHLS_INPUT()
{
  testStepPass("doc-trace", "UT_044 - 전조등 높이 제어 상태를 입력");
  testStepPass("closeout-smoke", "Closeout smoke: representative input reflection and testcase verdict drive the final ID judgment.");
  if (!resetValidationHarnessIfNeeded())
  {
    return;
  }

  gAhlsAssistState = -1;
  gHighBeamPermit = -1;
  if (!launchScenarioAndWait(230, 800, 1300))
  {
    return;
  }

  if (!waitForAhlsInputState(800))
  {
    resetValidationHarnessIfNeeded();
    return;
  }

  assertIntEq("s230_ahlsAssistState", 1, gAhlsAssistState, "ahlsAssistState");
  assertIntMin("s230_highBeamPermit-floor", 0, gHighBeamPermit, "highBeamPermit");

  testStepPass("doc-pass", "PASS - UT_044 - 전조등 높이 제어 상태를 입력");
  resetValidationHarnessIfNeeded();
}