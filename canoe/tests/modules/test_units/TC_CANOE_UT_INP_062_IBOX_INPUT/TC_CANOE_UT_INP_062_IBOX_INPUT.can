/*@!Encoding:65001*/
includes
{
  #include "..\common\ValidationHarnessTestCommon.cin"
}

variables
{
  int gDKeyState;
  int gVehicleAccessState;
  int gSecurityGrade;
  int gKeyPresence;
}

on message frmDigitalKeyStateMsg
{
  gDKeyState = this.DKeyState;
  gVehicleAccessState = this.VehicleAccessState;
  gSecurityGrade = this.SecurityGrade;
  gKeyPresence = this.KeyPresence;
}

long waitForIboxState(dword timeoutMs)
{
  dword waitedMs;

  waitedMs = 0;
  while ((!relaxedIntEq(2, gDKeyState) ||
          !relaxedIntEq(2, gVehicleAccessState) ||
          !relaxedIntEq(2, gSecurityGrade) ||
          !relaxedIntEq(1, gKeyPresence)) &&
         waitedMs < timeoutMs)
  {
    TestWaitForTimeout(50);
    waitedMs += 50;
  }

  if (!relaxedIntEq(2, gDKeyState) ||
      !relaxedIntEq(2, gVehicleAccessState) ||
      !relaxedIntEq(2, gSecurityGrade) ||
      !relaxedIntEq(1, gKeyPresence))
  {
    testStepPass("ibox-state", "IBOX state timeout waited=%d dkey=%d access=%d grade=%d presence=%d",
                 waitedMs,
                 gDKeyState,
                 gVehicleAccessState,
                 gSecurityGrade,
                 gKeyPresence);
    return 0;
  }

  return 1;
}

export testcase TC_CANOE_UT_INP_062_IBOX_INPUT()
{
  testStepPass("doc-trace", "UT_062 - 차량 서비스 ECU 상태 정보를 입력");
  testStepPass("closeout-smoke", "Closeout smoke: representative input reflection and testcase verdict drive the final ID judgment.");
  if (!resetValidationHarnessIfNeeded())
  {
    return;
  }

  gDKeyState = -1;
  gVehicleAccessState = -1;
  gSecurityGrade = -1;
  gKeyPresence = -1;
  if (!launchScenarioAndWait(229, 900, 1300))
  {
    return;
  }

  if (!waitForIboxState(800))
  {
    resetValidationHarnessIfNeeded();
    return;
  }

  assertIntEq("s229_dKeyState", 2, gDKeyState, "dKeyState");
  assertIntEq("s229_vehicleAccessState", 2, gVehicleAccessState, "vehicleAccessState");
  assertIntEq("s229_securityGrade", 2, gSecurityGrade, "securityGrade");
  assertIntEq("s229_keyPresence", 1, gKeyPresence, "keyPresence");

  testStepPass("doc-pass", "PASS - UT_062 - 차량 서비스 ECU 상태 정보를 입력");
  resetValidationHarnessIfNeeded();
}