/*@!Encoding:65001*/
includes
{
  #include "..\\common\\ValidationHarnessTestCommon.cin"
}

variables
{
}

export testcase TC_CANOE_UT_CORE_001_CGW_CHS_GW()
{
  testStepPass("doc-trace", "UT_001 - 차량 기본 입력과 차체 상태 정보를 수신하여 100ms 주기로 경계 경로에 전달");
  testStepPass("closeout-smoke", "Closeout smoke: representative input reflection and testcase verdict drive the final ID judgment.");
  if (!resetValidationHarnessIfNeeded())
  {
    return;
  }

  if (!launchScenarioAndWait(216, 1500, 2000))
  {
    return;
  }
  if (!waitForCoreDriveState(0, 0, 0, 1200) ||
      !waitForCoreSelectedAlertState(0, 0, 1200))
  {
    resetValidationHarnessIfNeeded();
    return;
  }
  assertIntEq("chs-gw-park-drive", 0, (long)@Core::driveStateNorm, "driveStateNorm");
  assertIntEq("chs-gw-park-speed", 0, (long)@Core::vehicleSpeedNorm, "vehicleSpeedNorm");
  assertIntEq("chs-gw-park-failsafe", 0, (long)@Core::failSafeMode, "failSafeMode");

  if (!resetValidationHarnessIfNeeded())
  {
    return;
  }
  if (!launchScenarioAndWait(217, 1500, 2200))
  {
    return;
  }
  if (!waitForCoreDriveStateMinSpeed(3, 20, -1, 1600))
  {
    resetValidationHarnessIfNeeded();
    return;
  }
  assertIntEq("chs-gw-drive-state", 3, (long)@Core::driveStateNorm, "driveStateNorm");
  assertIntMin("chs-gw-drive-speed", 20, (long)@Core::vehicleSpeedNorm, "vehicleSpeedNorm");

  if (!resetValidationHarnessIfNeeded())
  {
    return;
  }
  if (!launchScenarioAndWait(218, 1500, 2200))
  {
    return;
  }
  if (!waitForCoreChassisState(20, 1, 0, -1, 1600))
  {
    resetValidationHarnessIfNeeded();
    return;
  }
  assertIntEq("chs-gw-steer-input", 1, (long)@Core::steeringInputNorm, "steeringInputNorm");
  assertIntMin("chs-gw-steer-speed", 20, (long)@Core::vehicleSpeedNorm, "vehicleSpeedNorm");

  if (!resetValidationHarnessIfNeeded())
  {
    return;
  }
  if (!launchScenarioAndWait(219, 1500, 2200))
  {
    return;
  }
  if (!waitForCoreChassisState(-1, -1, 20, -1, 1600))
  {
    resetValidationHarnessIfNeeded();
    return;
  }
  assertIntMin("chs-gw-brake-input", 20, (long)@Core::brakePedalNorm, "brakePedalNorm");
  assertIntEq("chs-gw-brake-drive", 0, (long)@Core::driveStateNorm, "driveStateNorm");

  testStepPass("doc-pass", "PASS - UT_001 - 차량 기본 입력과 차체 상태 정보를 수신하여 100ms 주기로 경계 경로에 전달");
  resetValidationHarnessIfNeeded();
}