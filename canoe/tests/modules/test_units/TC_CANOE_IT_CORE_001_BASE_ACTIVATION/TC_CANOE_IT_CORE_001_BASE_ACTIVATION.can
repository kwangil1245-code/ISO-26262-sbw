/*@!Encoding:65001*/
includes
{
  #include "..\\common\\ValidationHarnessTestCommon.cin"
}

variables
{
}

export testcase TC_CANOE_IT_CORE_001_BASE_ACTIVATION()
{
  testStepPass("doc-trace", "IT_001 - 주행 상태 변화에 따른 기본 경고 활성, 비활성, 해제 동작 통합 검증");
  testStepPass("closeout-smoke", "Closeout smoke: representative input reflection and testcase verdict drive the final ID judgment.");
  if (!resetValidationHarnessIfNeeded())
  {
    return;
  }

  if (!launchScenarioAndWait(1, 700, 1000))
  {
    return;
  }

  if (!waitForCoreSelectedAlertState(0, 0, 800) ||
      !waitForStableWarningRender(0, -1, 800))
  {
    resetValidationHarnessIfNeeded();
    return;
  }

  assertIntEq("idle-alert-level", 0, getCanonicalSelectedAlertLevel(), "selectedAlertLevel");
  assertIntEq("idle-warning-code", 0, (long)@Cluster::warningTextCode, "warningTextCode");

  if (!resetValidationHarnessIfNeeded())
  {
    return;
  }

  if (!launchScenarioAndWait(2, 700, 1200))
  {
    return;
  }

  if (!waitForNavContextState(1, 30, 800) ||
      !waitForCoreSelectedAlertState(3, 3, 800))
  {
    resetValidationHarnessIfNeeded();
    return;
  }

  assertIntEq("activation-alert-level", 3, getCanonicalSelectedAlertLevel(), "selectedAlertLevel");
  assertIntEq("activation-alert-type", 3, getCanonicalSelectedAlertType(), "selectedAlertType");

  if (!resetValidationHarnessIfNeeded())
  {
    return;
  }

  if (!launchScenarioAndWait(12, 900, 1400))
  {
    return;
  }

  if (!waitForCoreSelectedAlertState(3, 3, 800))
  {
    resetValidationHarnessIfNeeded();
    return;
  }

  assertIntEq("guard-alert-level", 3, getCanonicalSelectedAlertLevel(), "selectedAlertLevel");
  assertIntEq("guard-alert-type", 3, getCanonicalSelectedAlertType(), "selectedAlertType");
  assertIntMin("duplicate-popup-guard", 1, (long)@CoreState::duplicatePopupGuard, "duplicatePopupGuard");

  testStepPass("doc-pass", "PASS - IT_001 - 주행 상태 변화에 따른 기본 경고 활성, 비활성, 해제 동작 통합 검증");
  resetValidationHarnessIfNeeded();
}