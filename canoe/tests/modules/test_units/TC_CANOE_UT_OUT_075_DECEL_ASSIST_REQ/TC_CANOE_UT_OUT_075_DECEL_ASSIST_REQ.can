/*@!Encoding:65001*/
includes
{
  #include "..\\common\\ValidationHarnessTestCommon.cin"
}

export testcase TC_CANOE_UT_OUT_075_DECEL_ASSIST_REQ()
{
  testStepPass("doc-trace", "UT_075 - 위험도와 fail-safe 상태에 따라 자동 감속 보조 요청을 출력");
  testStepPass("closeout-smoke", "Closeout smoke: representative input reflection and testcase verdict drive the final ID judgment.");
  if (!resetValidationHarnessIfNeeded())
  {
    return;
  }

  if (!launchScenarioAndWait(16, 800, 1300))
  {
    return;
  }

  if (!waitForObservedDecelState(1, 1, 0, 1500) ||
      !waitForObservedSelectedAlertState(7, 2, 1500))
  {
    resetValidationHarnessIfNeeded();
    return;
  }
  assertLongGe("decel-assist-risk", (long)@Test::obsDecelRisk, 70, "ethDecelRisk");
  assertIntEq("decel-assist-decision", 1, (long)@Test::obsDecelDecisionReq, "ethDecelDecisionReq");
  assertIntEq("decel-assist-active", 1, (long)@Test::obsDecelAssistReq, "ethDecelAssistReq");
  assertIntEq("decel-assist-gate-clear", 0, (long)@Test::obsDecelGateReason, "ethDecelGateReason");
  assertIntEq("decel-assist-active-level", 7, (long)@Test::obsSelectedAlertLevel, "ethSelectedAlertLevel");

  if (!resetValidationHarnessIfNeeded())
  {
    return;
  }
  if (!launchScenarioAndWait(18, 1500, 1000))
  {
    return;
  }

  if (!waitForBaseResult(18, 2000))
  {
    return;
  }

  if (!waitForObservedDecelState(1, 0, 3, 1500) ||
      !waitForObservedFailSafeMin(1, 1500))
  {
    resetValidationHarnessIfNeeded();
    return;
  }
  assertIntEq("decel-assist-decision-held", 1, (long)@Test::obsDecelDecisionReq, "ethDecelDecisionReq");
  assertIntEq("decel-assist-blocked", 0, (long)@Test::obsDecelAssistReq, "ethDecelAssistReq");
  assertIntEq("decel-assist-gated", 3, (long)@Test::obsDecelGateReason, "ethDecelGateReason");
  assertIntMin("decel-assist-failsafe", 1, (long)@Test::obsFailSafeMode, "ethFailSafeMode");

  testStepPass("doc-pass", "PASS - UT_075 - 위험도와 fail-safe 상태에 따라 자동 감속 보조 요청을 출력");
  resetValidationHarnessIfNeeded();
}