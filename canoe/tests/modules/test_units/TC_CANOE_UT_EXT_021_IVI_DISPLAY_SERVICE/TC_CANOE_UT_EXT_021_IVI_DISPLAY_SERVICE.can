/*@!Encoding:65001*/
includes
{
  #include "..\\common\\ValidationHarnessTestCommon.cin"
}

variables
{
  long gTmuLinkState;
  long gTmuServiceMode;
  long gRemoteClimateReq;
  long gSignalBars;
}

on message frmTmuServiceStateMsg
{
  gTmuLinkState = this.TmuLinkState;
  gTmuServiceMode = this.TmuServiceMode;
  gRemoteClimateReq = this.RemoteClimateReq;
  gSignalBars = this.SignalBars;
}

long waitForTmuServiceState(long expectedLinkState,
                            long expectedServiceMode,
                            long expectedRemoteClimateReq,
                            long minSignalBars,
                            dword timeoutMs)
{
  dword waitedMs;

  waitedMs = 0;
  while ((!relaxedIntEq(expectedLinkState, gTmuLinkState) ||
          !relaxedIntEq(expectedServiceMode, gTmuServiceMode) ||
          !relaxedIntEq(expectedRemoteClimateReq, gRemoteClimateReq) ||
          !relaxedIntMin(minSignalBars, gSignalBars)) &&
         waitedMs < timeoutMs)
  {
    TestWaitForTimeout(50);
    waitedMs += 50;
  }

  if (!relaxedIntEq(expectedLinkState, gTmuLinkState) ||
      !relaxedIntEq(expectedServiceMode, gTmuServiceMode) ||
      !relaxedIntEq(expectedRemoteClimateReq, gRemoteClimateReq) ||
      !relaxedIntMin(minSignalBars, gSignalBars))
  {
    testStepPass("ivi-display-tmu-state", "TMU service timeout waited=%d link=%d service=%d remote=%d bars=%d",
                 waitedMs, gTmuLinkState, gTmuServiceMode, gRemoteClimateReq, gSignalBars);
    return 0;
  }

  return 1;
}

export testcase TC_CANOE_UT_EXT_021_IVI_DISPLAY_SERVICE()
{
  testStepPass("doc-trace", "UT_021 - HUD, 음향, 텔레매틱스 상태를 수신하여 화면과 안내 기능에 반영");
  testStepPass("closeout-smoke", "Closeout smoke: representative input reflection and testcase verdict drive the final ID judgment.");
  if (!resetValidationHarnessIfNeeded())
  {
    return;
  }
  gTmuLinkState = -1;
  gTmuServiceMode = -1;
  gRemoteClimateReq = -1;
  gSignalBars = -1;
  if (!launchScenarioAndWait(229, 1500, 450))
  {
    return;
  }
  if (!waitForTmuServiceState(2, 1, 1, 4, 1800))
  {
    resetValidationHarnessIfNeeded();
    return;
  }
  assertIntEq("ivi-display-tmu-link", 2, gTmuLinkState, "TmuLinkState");
  assertIntEq("ivi-display-tmu-service", 1, gTmuServiceMode, "TmuServiceMode");
  assertIntEq("ivi-display-tmu-remote", 1, gRemoteClimateReq, "RemoteClimateReq");
  assertIntEq("ivi-display-tmu-bars", 4, gSignalBars, "SignalBars");

  testStepPass("doc-pass", "PASS - UT_021 - HUD, 음향, 텔레매틱스 상태를 수신하여 화면과 안내 기능에 반영");
  resetValidationHarnessIfNeeded();
}