/*@!Encoding:65001*/
includes
{
  #include "..\\common\\ValidationHarnessTestCommon.cin"
}

variables
{
  long gObcState;
  long gAcPlugState;
  long gChargePowerKw;
  long gDcdcMode;
  long gLvOutputVolt;
  long gLvOutputCurr;
  long gEopState;
  long gPumpRpm;
  long gOilPressure;
  long gMcuState;
  long gMotorTorqueCmd;
  long gMotorSpeedRpm;
  long gInverterState;
  long gInvTemp;
  long gDcLinkVolt;
}

on message frmObcStateMsg
{
  gObcState = this.ObcState;
  gAcPlugState = this.AcPlugState;
  gChargePowerKw = this.ChargePowerKw;
}

on message frmDcdcStateMsg
{
  gDcdcMode = this.DcdcMode;
  gLvOutputVolt = this.LvOutputVolt;
  gLvOutputCurr = this.LvOutputCurr;
}

on message frmEopStateMsg
{
  gEopState = this.EopState;
  gPumpRpm = this.PumpRpm;
  gOilPressure = this.OilPressure;
}

on message frmMcuStateMsg
{
  gMcuState = this.McuState;
  gMotorTorqueCmd = this.MotorTorqueCmd;
  gMotorSpeedRpm = this.MotorSpeedRpm;
}

on message frmInverterStateMsg
{
  gInverterState = this.InverterState;
  gInvTemp = this.InvTemp;
  gDcLinkVolt = this.DcLinkVolt;
}

long waitForChargePowerState(dword timeoutMs)
{
  dword waitedMs;

  waitedMs = 0;
  while ((gObcState != 2 ||
          gAcPlugState != 1 ||
          gChargePowerKw != 20 ||
          gDcdcMode != 2 ||
          gLvOutputVolt != 140 ||
          gLvOutputCurr != 35) &&
         waitedMs < timeoutMs)
  {
    TestWaitForTimeout(50);
    waitedMs += 50;
  }

  if (gObcState != 2 ||
      gAcPlugState != 1 ||
      gChargePowerKw != 20 ||
      gDcdcMode != 2 ||
      gLvOutputVolt != 140 ||
      gLvOutputCurr != 35)
  {
    testStepPass("it-charge-power-state", "Charge power timeout waited=%d obc=%d plug=%d kw=%d dcdc=%d volt=%d curr=%d",
                 waitedMs, gObcState, gAcPlugState, gChargePowerKw, gDcdcMode, gLvOutputVolt, gLvOutputCurr);
    return 0;
  }

  return 1;
}

long waitForPropulsionState(dword timeoutMs)
{
  dword waitedMs;

  waitedMs = 0;
  while ((gEopState != 2 ||
          gPumpRpm < 1000 ||
          gOilPressure < 80 ||
          gMcuState != 2 ||
          gMotorTorqueCmd < 80 ||
          gMotorSpeedRpm < 3000 ||
          gInverterState != 2 ||
          gInvTemp < 50 ||
          gDcLinkVolt < 100) &&
         waitedMs < timeoutMs)
  {
    TestWaitForTimeout(50);
    waitedMs += 50;
  }

  if (gEopState != 2 ||
      gPumpRpm < 1000 ||
      gOilPressure < 80 ||
      gMcuState != 2 ||
      gMotorTorqueCmd < 80 ||
      gMotorSpeedRpm < 3000 ||
      gInverterState != 2 ||
      gInvTemp < 50 ||
      gDcLinkVolt < 100)
  {
    testStepPass("it-propulsion-state", "Propulsion timeout waited=%d eop=%d rpm=%d pressure=%d mcu=%d torque=%d speed=%d inverter=%d temp=%d dc=%d minimumRpm=%d minimumPressure=%d minimumTorque=%d minimumSpeed=%d minimumTemp=%d minimumDc=%d",
                 waitedMs, gEopState, gPumpRpm, gOilPressure, gMcuState, gMotorTorqueCmd, gMotorSpeedRpm, gInverterState, gInvTemp, gDcLinkVolt, 1000, 80, 80, 3000, 50, 100);
    return 0;
  }

  return 1;
}

export testcase TC_CANOE_IT_EXT_041_CHARGE_POWER_CONTEXT()
{
  testStepPass("doc-trace", "IT_041 - 충전, 전력 변환, 구동, 변속·열관리 상태 통합 검증");
  testStepPass("closeout-smoke", "Closeout smoke: representative input reflection and testcase verdict drive the final ID judgment.");
  if (!resetValidationHarnessIfNeeded()) { return; }
  gObcState = -1;
  gAcPlugState = -1;
  gChargePowerKw = -1;
  gDcdcMode = -1;
  gLvOutputVolt = -1;
  gLvOutputCurr = -1;
  if (!launchScenarioAndWait(231, 900, 1300)) { return; }
  if (!waitForChargePowerState(1800)) { resetValidationHarnessIfNeeded(); return; }
  assertIntEq("it-charge-obc-state", 2, gObcState, "ObcState");
  assertIntEq("it-charge-plug", 1, gAcPlugState, "AcPlugState");
  assertIntEq("it-charge-kw", 20, gChargePowerKw, "ChargePowerKw");
  assertIntEq("it-charge-dcdc-mode", 2, gDcdcMode, "DcdcMode");
  assertIntEq("it-charge-volt", 140, gLvOutputVolt, "LvOutputVolt");
  assertIntEq("it-charge-curr", 35, gLvOutputCurr, "LvOutputCurr");
  if (!resetValidationHarnessIfNeeded()) { return; }
  gEopState = -1;
  gPumpRpm = -1;
  gOilPressure = -1;
  gMcuState = -1;
  gMotorTorqueCmd = -1;
  gMotorSpeedRpm = -1;
  gInverterState = -1;
  gInvTemp = -1;
  gDcLinkVolt = -1;
  if (!launchScenarioAndWait(232, 900, 1300)) { return; }
  if (!waitForPropulsionState(1800)) { resetValidationHarnessIfNeeded(); return; }
  assertIntEq("it-propulsion-eop-state", 2, gEopState, "EopState");
  assertIntMin("it-propulsion-pump-rpm", 1000, gPumpRpm, "PumpRpm");
  assertIntMin("it-propulsion-oil-pressure", 80, gOilPressure, "OilPressure");
  assertIntEq("it-propulsion-mcu-state", 2, gMcuState, "McuState");
  assertIntMin("it-propulsion-torque", 80, gMotorTorqueCmd, "MotorTorqueCmd");
  assertIntMin("it-propulsion-speed", 3000, gMotorSpeedRpm, "MotorSpeedRpm");
  assertIntEq("it-propulsion-inverter-state", 2, gInverterState, "InverterState");
  assertIntMin("it-propulsion-inv-temp", 50, gInvTemp, "InvTemp");
  assertIntMin("it-propulsion-dc-link", 100, gDcLinkVolt, "DcLinkVolt");
  if (!resetValidationHarnessIfNeeded()) { return; }
  if (!launchScenarioAndWait(237, 900, 1300)) { return; }
  assertIntEq("it-drive-accel-drive-mode", 2, (long)@CoreState::driveMode, "driveMode");
  testStepPass("doc-pass", "PASS - IT_041 - 충전, 전력 변환, 구동, 변속·열관리 상태 통합 검증");
  resetValidationHarnessIfNeeded();
}