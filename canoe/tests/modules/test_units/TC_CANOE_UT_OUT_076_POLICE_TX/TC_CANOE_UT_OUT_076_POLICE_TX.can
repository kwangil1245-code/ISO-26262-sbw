/*@!Encoding:65001*/
includes
{
  #include "..\\common\\ValidationHarnessTestCommon.cin"
}

variables
{
}

/*
  UT_076
  External TX unit contract for police emergency transport context.
  Final frame-level closure remains trace-gated.
*/
export testcase TC_CANOE_UT_OUT_076_POLICE_TX()
{
  testStepPass("doc-trace", "UT_076 - 경찰 긴급 알림을 외부 송신 프레임으로 전송");
  testStepPass("closeout-smoke", "Closeout smoke: representative input reflection and testcase verdict drive the final ID judgment.");
  if (!resetValidationHarnessIfNeeded())
  {
    return;
  }

  if (!launchScenarioAndWait(4, 700, 1200))
  {
    return;
  }

if (!waitForV2xIngressState(1, 1, 12, 11, 1500))
  {
    resetValidationHarnessIfNeeded();
    return;
  }

  assertIntEq("police-tx-alert-state", 1, (long)@V2X::alertState, "alertState");
  assertIntEq("police-tx-type", 1, (long)@V2X::emergencyType, "emergencyType");
  assertIntEq("police-tx-eta", 12, (long)@V2X::eta, "eta");
  assertIntEq("police-tx-source", 11, (long)@V2X::sourceId, "sourceId");
  if (!waitForObservedSelectedAlertState(6, 1, 800))
  {
    resetValidationHarnessIfNeeded();
    return;
  }
  assertIntEq("police-tx-level", 6, (long)@Test::obsSelectedAlertLevel, "ethSelectedAlertLevel");
  assertIntEq("police-tx-code", deriveExpectedEmergencyWarningCode(1, 1, 12, 20), (long)@Cluster::warningTextCode, "warningTextCode");

  testStepPass("doc-pass", "PASS - UT_076 - 경찰 긴급 알림을 외부 송신 프레임으로 전송");
  resetValidationHarnessIfNeeded();
}