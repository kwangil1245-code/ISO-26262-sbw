/*@!Encoding:65001*/
includes
{
  #include "..\\common\\ValidationHarnessTestCommon.cin"
}

variables
{
}

export testcase TC_CANOE_UT_CORE_005_ADAS_DECEL_ASSIST()
{
  testStepPass("doc-trace", "UT_005 - 긴급차량 방향과 접근 시간을 반영하여 위험도와 감속 보조를 판단");
  testStepPass("closeout-smoke", "Closeout smoke: representative input reflection and testcase verdict drive the final ID judgment.");
  if (!resetValidationHarnessIfNeeded())
  {
    return;
  }

  if (!launchScenarioAndWait(16, 800, 1300))
  {
    return;
  }

  if (!waitForObservedDecelState(1, 1, 0, 800) ||
      !waitForObservedSelectedAlertState(7, 2, 800) ||
      !waitForObservedFailSafe(1200))
  {
    resetValidationHarnessIfNeeded();
    return;
  }
  assertIntEq("decel-decision-req", 1, (long)@Test::obsDecelDecisionReq, "ethDecelDecisionReq");
  assertIntEq("decel-assist-req", 1, (long)@Test::obsDecelAssistReq, "ethDecelAssistReq");
  assertIntEq("decel-gate-clear", 0, (long)@Test::obsDecelGateReason, "ethDecelGateReason");
  assertLongGe("proximity-risk-level", (long)@Test::obsDecelRisk, 70, "ethDecelRisk");
  assertIntEq("fail-safe-clear", 0, (long)@Test::obsFailSafeMode, "ethFailSafeMode");
  assertIntEq("selected-alert-level", 7, (long)@Test::obsSelectedAlertLevel, "ethSelectedAlertLevel");
  assertIntEq("selected-alert-type", 2, (long)@Test::obsSelectedAlertType, "ethSelectedAlertType");

  testStepPass("doc-pass", "PASS - UT_005 - 긴급차량 방향과 접근 시간을 반영하여 위험도와 감속 보조를 판단");
  resetValidationHarnessIfNeeded();
}