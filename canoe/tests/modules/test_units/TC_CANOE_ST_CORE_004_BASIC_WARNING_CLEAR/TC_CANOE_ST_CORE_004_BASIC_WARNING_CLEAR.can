/*@!Encoding:65001*/
includes
{
  #include "..\\common\\ValidationHarnessTestCommon.cin"
}

variables
{
}

export testcase TC_CANOE_ST_CORE_004_BASIC_WARNING_CLEAR()
{
  testStepPass("doc-trace", "ST_004 - 일반 구간에서 기본 경고 조건이 해제되면 경고가 정상 해제되는지 확인한다.");
  testStepPass("closeout-smoke", "Closeout smoke: representative input reflection and testcase verdict drive the final ID judgment.");
  if (!resetValidationHarnessIfNeeded())
  {
    return;
  }

  if (!launchScenarioAndWait(26, 700, 1000))
  {
    return;
  }

  if (!waitForCoreSelectedAlertState(1, 1, 800))
  {
    resetValidationHarnessIfNeeded();
    return;
  }

  assertIntEq("st004-active-level", 1, getCanonicalSelectedAlertLevel(), "selectedAlertLevel");

  if (!launchScenarioAndWait(1, 700, 1000))
  {
    return;
  }

  if (!waitForCoreSelectedAlertState(0, 0, 800) ||
      !waitForStableWarningRender(0, -1, 800) ||
      !waitForCoreDriveState(-1, -1, 0, 800))
  {
    resetValidationHarnessIfNeeded();
    return;
  }

  assertIntEq("st004-clear-level", 0, getCanonicalSelectedAlertLevel(), "selectedAlertLevel");
  assertIntEq("st004-clear-type", 0, getCanonicalSelectedAlertType(), "selectedAlertType");
  assertIntEq("st004-clear-code", 0, (long)@Cluster::warningTextCode, "warningTextCode");
  assertIntEq("st004-clear-failsafe", 0, (long)@Core::failSafeMode, "failSafeMode");

  testStepPass("doc-pass", "PASS - ST_004 - 일반 구간에서 기본 경고 조건이 해제되면 경고가 정상 해제되는지 확인한다.");
  resetValidationHarnessIfNeeded();
}