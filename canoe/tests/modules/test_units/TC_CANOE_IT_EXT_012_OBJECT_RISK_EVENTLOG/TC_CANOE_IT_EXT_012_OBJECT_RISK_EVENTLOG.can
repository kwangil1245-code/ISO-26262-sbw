/*@!Encoding:65001*/
includes
{
  #include "..\\common\\ValidationHarnessTestCommon.cin"
}

variables
{
}

export testcase TC_CANOE_IT_EXT_012_OBJECT_RISK_EVENTLOG()
{
  testStepPass("doc-trace", "IT_012 - 객체 위험 판단, 입력 유효성 필터링 및 이벤트 기록 통합 검증");
  testStepPass("closeout-smoke", "Closeout smoke: representative input reflection and testcase verdict drive the final ID judgment.");
  if (!resetValidationHarnessIfNeeded())
  {
    return;
  }

  if (!launchScenarioAndWait(20, 700, 1200))
  {
    return;
  }

  if (!waitForObservedObjectRiskMin(3, 60, 1200))
  {
    resetValidationHarnessIfNeeded();
    return;
  }
  assertIntMin("forward-conflict-risk-class", 3, (long)@Test::obsObjectRiskClass, "ethObjectRiskClass");
  assertIntMin("forward-conflict-proximity", 60, (long)@Test::obsObjectRiskLevel, "ethObjectRiskLevel");

  if (!resetValidationHarnessIfNeeded())
  {
    return;
  }

  if (!launchScenarioAndWait(21, 700, 1200))
  {
    return;
  }

  if (!waitForObservedObjectRiskMin(2, 40, 1200) ||
      !waitForObservedIntersectionConflict(1200) ||
      !waitForObservedSelectedAlertType(5, 1200))
  {
    resetValidationHarnessIfNeeded();
    return;
  }
  assertIntEq("intersection-flag", 1, (long)@Test::obsIntersectionConflictFlag, "ethIntersectionConflictFlag");
  assertIntMin("intersection-risk-class", 3, (long)@Test::obsObjectRiskClass, "ethObjectRiskClass");
  assertIntEq("intersection-alert-type", 5, (long)@Test::obsSelectedAlertType, "ethSelectedAlertType");

  if (!resetValidationHarnessIfNeeded())
  {
    return;
  }

  if (!launchScenarioAndWait(22, 700, 1200))
  {
    return;
  }

  if (!waitForObservedObjectRiskMin(2, 40, 1200) ||
      !waitForObservedMergeCutIn(1200) ||
      !waitForObservedSelectedAlertType(6, 1200))
  {
    resetValidationHarnessIfNeeded();
    return;
  }
  assertIntEq("merge-cutin-flag", 1, (long)@Test::obsMergeCutInFlag, "ethMergeCutInFlag");
  assertIntMin("merge-cutin-risk-class", 3, (long)@Test::obsObjectRiskClass, "ethObjectRiskClass");
  assertIntEq("merge-cutin-alert-type", 6, (long)@Test::obsSelectedAlertType, "ethSelectedAlertType");

  if (!resetValidationHarnessIfNeeded())
  {
    return;
  }

  if (!launchScenarioAndWait(24, 700, 1200))
  {
    return;
  }

  if (!waitForObservedObjectRisk(1200) ||
      !waitForObservedFailSafeMin(1, 1500) ||
      !waitForObservedDecelState(-1, 0, -1, 1200))
  {
    resetValidationHarnessIfNeeded();
    return;
  }
  assertIntEq("confidence-value", 20, (long)@Test::obsObjectConfidence, "ethObjectConfidence");
  assertIntMin("confidence-degrade-failsafe", 1, (long)@Test::obsFailSafeMode, "ethFailSafeMode");
  assertIntEq("confidence-degrade-decel-off", 0, (long)@Test::obsDecelAssistReq, "ethDecelAssistReq");

  if (!resetValidationHarnessIfNeeded())
  {
    return;
  }

  if (!launchScenarioAndWait(25, 1100, 1500))
  {
    return;
  }

  if (!waitForObservedObjectRisk(800))
  {
    resetValidationHarnessIfNeeded();
    return;
  }
  assertIntEq("tracking-loss-track-valid", 1, (long)@Test::obsObjectTrackValid, "ethObjectTrackValid");
  assertIntMin("tracking-loss-risk-class", 3, (long)@Test::obsObjectRiskClass, "ethObjectRiskClass");
  assertIntMin("tracking-loss-event-code", 1381, (long)@Core::objectEventCode, "objectEventCode");

  testStepPass("doc-pass", "PASS - IT_012 - 객체 위험 판단, 입력 유효성 필터링 및 이벤트 기록 통합 검증");
  resetValidationHarnessIfNeeded();
}