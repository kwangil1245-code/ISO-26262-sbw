/*@!Encoding:65001*/
includes
{
  #include "..\\common\\ValidationHarnessTestCommon.cin"
}

variables
{
}

export testcase TC_CANOE_ST_CORE_008_STEERING_INACTIVITY()
{
  testStepPass("doc-trace", "ST_008 - 고속 구간 주행 중 무조향 조건이 지속되면 경고가 발생하고 조향 입력 복귀 후 해제되는지 확인한다.");
  testStepPass("closeout-smoke", "Closeout smoke: representative input reflection and testcase verdict drive the final ID judgment.");
  if (!resetValidationHarnessIfNeeded())
  {
    return;
  }

  if (!launchScenarioAndWait(244, 900, 1300))
  {
    return;
  }
  if (!waitForNavContextState(2, -1, 800) ||
      !waitForCoreSelectedAlertState(0, 0, 800))
  {
    resetValidationHarnessIfNeeded();
    return;
  }

  assertIntEq("st008-highway-zone", 2, (long)@Core::baseZoneContext, "baseZoneContext");
  assertIntEq("st008-highway-level", 0, getCanonicalSelectedAlertLevel(), "selectedAlertLevel");

  if (!launchScenarioAndWait(3, 11000, 11600))
  {
    return;
  }
  if (!waitForCoreSelectedAlertState(2, 4, 1200))
  {
    resetValidationHarnessIfNeeded();
    return;
  }

  assertIntEq("st008-trigger-level", 2, getCanonicalSelectedAlertLevel(), "selectedAlertLevel");
  assertIntEq("st008-trigger-type", 4, getCanonicalSelectedAlertType(), "selectedAlertType");

  if (!launchScenarioAndWait(244, 900, 1300))
  {
    return;
  }
  if (!waitForCoreSelectedAlertState(0, 0, 800))
  {
    resetValidationHarnessIfNeeded();
    return;
  }

  assertIntEq("st008-clear-level", 0, getCanonicalSelectedAlertLevel(), "selectedAlertLevel");
  assertIntEq("st008-clear-type", 0, getCanonicalSelectedAlertType(), "selectedAlertType");

  testStepPass("doc-pass", "PASS - ST_008 - 고속 구간 주행 중 무조향 조건이 지속되면 경고가 발생하고 조향 입력 복귀 후 해제되는지 확인한다.");
  resetValidationHarnessIfNeeded();
}