/*@!Encoding:65001*/
includes
{
  #include "..\\common\\ValidationHarnessTestCommon.cin"
}

variables
{
}

export testcase TC_CANOE_ST_V2_012_AMBULANCE_OVERRIDE()
{
  testStepPass("doc-trace", "ST_012 - 구급 긴급 접근이 일반 구간 경고와 동시에 발생할 때 구급 경고가 우선 표시되는지 확인한다.");
  testStepPass("closeout-smoke", "Closeout smoke: representative input reflection and testcase verdict drive the final ID judgment.");
  if (!resetValidationHarnessIfNeeded())
  {
    return;
  }

  if (!launchScenarioAndWait(223, 800, 1300))
  {
    return;
  }

  if (!waitForObservedSelectedAlertState(7, 2, 800) ||
      !waitForObservedFailSafe(1200))
  {
    resetValidationHarnessIfNeeded();
    return;
  }
  assertIntEq("ambulance-override-level", 7, (long)@Test::obsSelectedAlertLevel, "ethSelectedAlertLevel");
  assertIntEq("ambulance-override-type", 2, (long)@Test::obsSelectedAlertType, "ethSelectedAlertType");
  assertIntEq("ambulance-override-failsafe", 0, (long)@Test::obsFailSafeMode, "ethFailSafeMode");
  assertIntMin("ambulance-override-arbitration", 1, (long)@Test::baseTraceSnapshotId, "baseTraceSnapshotId");

  testStepPass("doc-pass", "PASS - ST_012 - 구급 긴급 접근이 일반 구간 경고와 동시에 발생할 때 구급 경고가 우선 표시되는지 확인한다.");
  resetValidationHarnessIfNeeded();
}