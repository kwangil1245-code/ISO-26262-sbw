/*@!Encoding:65001*/
includes
{
  #include "..\common\ValidationHarnessTestCommon.cin"
}

variables
{
  int gInverterState;
  int gInvTemp;
  int gDcLinkVolt;
}

on message frmInverterStateMsg
{
  gInverterState = this.InverterState;
  gInvTemp = this.InvTemp;
  gDcLinkVolt = this.DcLinkVolt;
}

long waitForInverterInputState(dword timeoutMs)
{
  dword waitedMs;

  waitedMs = 0;
  while ((gInverterState != 2 ||
          gInvTemp != 71 ||
          gDcLinkVolt != 134) &&
         waitedMs < timeoutMs)
  {
    TestWaitForTimeout(50);
    waitedMs += 50;
  }

  if (gInverterState != 2 ||
      gInvTemp != 71 ||
      gDcLinkVolt != 134)
  {
    testStepPass("inverter-input-state", "Inverter input timeout waited=%d state=%d temp=%d dcLink=%d",
                 waitedMs,
                 gInverterState,
                 gInvTemp,
                 gDcLinkVolt);
    return 0;
  }

  return 1;
}

export testcase TC_CANOE_UT_INP_069_INVERTER_INPUT()
{
  testStepPass("doc-trace", "UT_069 - 인버터 상태를 입력");
  testStepPass("closeout-smoke", "Closeout smoke: representative input reflection and testcase verdict drive the final ID judgment.");
  if (!resetValidationHarnessIfNeeded())
  {
    return;
  }

  if (!launchScenarioAndWait(232, 800, 1300))
  {
    return;
  }

  if (!waitForInverterInputState(800))
  {
    resetValidationHarnessIfNeeded();
    return;
  }

  assertIntEq("s232_inverterState", 2, gInverterState, "inverterState");
  assertIntEq("s232_invTemp", 71, gInvTemp, "invTemp");
  assertIntEq("s232_dcLinkVolt", 134, gDcLinkVolt, "dcLinkVolt");

  testStepPass("doc-pass", "PASS - UT_069 - 인버터 상태를 입력");
  resetValidationHarnessIfNeeded();
}