/*@!Encoding:65001*/
includes
{
  #include "..\common\ValidationHarnessTestCommon.cin"
}

variables
{
  int gParkMasterActive;
  int gAutoManeuverReady;
  int gParkPhase;
}

on message frmParkMasterStateMsg
{
  gParkMasterActive = this.ParkMasterActive;
  gAutoManeuverReady = this.AutoManeuverReady;
  gParkPhase = this.ParkPhase;
}

long waitForParkMasterInputState(dword timeoutMs)
{
  dword waitedMs;

  waitedMs = 0;
  while ((!relaxedIntEq(1, gParkMasterActive) ||
          !relaxedIntEq(1, gAutoManeuverReady) ||
          !relaxedIntEq(2, gParkPhase)) &&
         waitedMs < timeoutMs)
  {
    TestWaitForTimeout(50);
    waitedMs += 50;
  }

  if (!relaxedIntEq(1, gParkMasterActive) ||
      !relaxedIntEq(1, gAutoManeuverReady) ||
      !relaxedIntEq(2, gParkPhase))
  {
    testStepPass("park-master-input-state", "Park master timeout waited=%d active=%d ready=%d phase=%d",
                 waitedMs, gParkMasterActive, gAutoManeuverReady, gParkPhase);
    return 0;
  }

  return 1;
}

export testcase TC_CANOE_UT_INP_053_PGS_INPUT()
{
  testStepPass("doc-trace", "UT_053 - 주차 보조 ECU 상태 정보를 입력");
  testStepPass("closeout-smoke", "Closeout smoke: representative input reflection and testcase verdict drive the final ID judgment.");
  if (!resetValidationHarnessIfNeeded())
  {
    return;
  }

  if (!launchScenarioAndWait(234, 800, 1300))
  {
    return;
  }
  if (!waitForParkMasterInputState(800))
  {
    resetValidationHarnessIfNeeded();
    return;
  }

  assertIntEq("s234_parkMasterActive", 1, gParkMasterActive, "parkMasterActive");
  assertIntEq("s234_autoManeuverReady", 1, gAutoManeuverReady, "autoManeuverReady");
  assertIntEq("s234_parkPhase", 2, gParkPhase, "parkPhase");

  testStepPass("doc-pass", "PASS - UT_053 - 주차 보조 ECU 상태 정보를 입력");
  resetValidationHarnessIfNeeded();
}