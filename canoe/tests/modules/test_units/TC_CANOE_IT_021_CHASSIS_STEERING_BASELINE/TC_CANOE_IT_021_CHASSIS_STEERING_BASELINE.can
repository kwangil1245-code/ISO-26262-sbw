/*@!Encoding:65001*/
includes
{
  #include "..\common\ValidationHarnessTestCommon.cin"
}

variables
{
}

export testcase TC_CANOE_IT_021_CHASSIS_STEERING_BASELINE()
{
  testStepPass("doc-trace", "IT_021 - 조향 입력 기준 chassis 상태 반영 통합 검증");
  testStepPass("closeout-smoke", "Closeout smoke: representative input reflection and testcase verdict drive the final ID judgment.");
  if (!resetValidationHarnessIfNeeded())
  {
    return;
  }

  if (!launchScenarioAndWait(218, 1500, 2200))
  {
    return;
  }
  if (!waitForCoreChassisState(20, 1, 0, -1, 1600))
  {
    resetValidationHarnessIfNeeded();
    return;
  }

  assertIntMin("chassis-steer-speed", 20, (long)@Core::vehicleSpeedNorm, "vehicleSpeedNorm");
  assertIntEq("chassis-steer-input", 1, (long)@Core::steeringInputNorm, "steeringInputNorm");
  assertIntEq("chassis-steer-brake", 0, (long)@Core::brakePedalNorm, "brakePedalNorm");

  testStepPass("doc-pass", "PASS - IT_021 - 조향 입력 기준 chassis 상태 반영 통합 검증");
  resetValidationHarnessIfNeeded();
}