/*@!Encoding:65001*/
includes
{
  #include "..\\common\\ValidationHarnessTestCommon.cin"
}

variables
{
}

export testcase TC_CANOE_ST_V2_020_TIMEOUT_CLEAR()
{
  testStepPass("doc-trace", "ST_020 - 긴급 알림이 `1000ms` 동안 갱신되지 않을 때 경고가 안전하게 해제되고 기본 상태로 복귀되는지 확인한다.");
  testStepPass("closeout-smoke", "Closeout smoke: representative input reflection and testcase verdict drive the final ID judgment.");
  if (!resetValidationHarnessIfNeeded())
  {
    return;
  }

  if (!launchScenarioAndWait(35, 1800, 2300))
  {
    return;
  }

  if (!waitForObservedSelectedAlertState(3, 3, 800))
  {
    resetValidationHarnessIfNeeded();
    return;
  }
  assertIntEq("timeout-clear-level", 3, (long)@Test::obsSelectedAlertLevel, "ethSelectedAlertLevel");
  assertIntEq("timeout-clear-type", 3, (long)@Test::obsSelectedAlertType, "ethSelectedAlertType");
  assertIntEq("timeout-clear-observed-emergency-context", 0, (long)@Test::obsEmergencyContext, "ethEmergencyContext");
  assertIntEq("timeout-clear-observed-failsafe", 0, (long)@Test::obsFailSafeMode, "ethFailSafeMode");
  assertIntEq("timeout-clear-emergency-context", 0, (long)@Core::emergencyContext, "emergencyContext");
  assertIntEq("timeout-clear-failsafe", 0, (long)@Core::failSafeMode, "failSafeMode");

  testStepPass("doc-pass", "PASS - ST_020 - 긴급 알림이 `1000ms` 동안 갱신되지 않을 때 경고가 안전하게 해제되고 기본 상태로 복귀되는지 확인한다.");
  resetValidationHarnessIfNeeded();
}