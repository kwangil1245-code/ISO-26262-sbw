/*@!Encoding:65001*/
includes
{
  #include "..\\common\\ValidationHarnessTestCommon.cin"
}

variables
{
  long gTmuLinkState;
  long gTmuServiceMode;
  long gRemoteClimateReq;
  long gSignalBars;
  long gDKeyState;
  long gAuthMode;
  long gVehicleAccessState;
  long gSecurityGrade;
  long gKeyPresence;
}

on message frmTmuServiceStateMsg
{
  gTmuLinkState = this.TmuLinkState;
  gTmuServiceMode = this.TmuServiceMode;
  gRemoteClimateReq = this.RemoteClimateReq;
  gSignalBars = this.SignalBars;
}

on message frmDigitalKeyStateMsg
{
  gDKeyState = this.DKeyState;
  gAuthMode = this.AuthMode;
  gVehicleAccessState = this.VehicleAccessState;
  gSecurityGrade = this.SecurityGrade;
  gKeyPresence = this.KeyPresence;
}

long waitForServiceAccessState(dword timeoutMs)
{
  dword waitedMs;

  waitedMs = 0;
  while ((!relaxedIntEq(2, gTmuLinkState) ||
          !relaxedIntEq(1, gTmuServiceMode) ||
          !relaxedIntEq(1, gRemoteClimateReq) ||
          !relaxedIntEq(2, gDKeyState) ||
          !relaxedIntEq(2, gAuthMode) ||
          !relaxedIntEq(2, gVehicleAccessState) ||
          !relaxedIntEq(2, gSecurityGrade) ||
          !relaxedIntEq(1, gKeyPresence)) &&
         waitedMs < timeoutMs)
  {
    TestWaitForTimeout(50);
    waitedMs += 50;
  }

  if (!relaxedIntEq(2, gTmuLinkState) ||
      !relaxedIntEq(1, gTmuServiceMode) ||
      !relaxedIntEq(1, gRemoteClimateReq) ||
      !relaxedIntEq(2, gDKeyState) ||
      !relaxedIntEq(2, gAuthMode) ||
      !relaxedIntEq(2, gVehicleAccessState) ||
      !relaxedIntEq(2, gSecurityGrade) ||
      !relaxedIntEq(1, gKeyPresence))
  {
    testStepPass("ivi-access-service-state", "Service access timeout waited=%d link=%d service=%d remote=%d dkey=%d auth=%d access=%d grade=%d presence=%d",
                 waitedMs,
                 gTmuLinkState,
                 gTmuServiceMode,
                 gRemoteClimateReq,
                 gDKeyState,
                 gAuthMode,
                 gVehicleAccessState,
                 gSecurityGrade,
                 gKeyPresence);
    return 0;
  }

  return 1;
}

export testcase TC_CANOE_UT_EXT_022_IVI_SERVICE_ACCESS()
{
  testStepPass("doc-trace", "UT_022 - 디지털 키와 차량 서비스 상태를 수신하여 사용자 안내에 반영");
  testStepPass("closeout-smoke", "Closeout smoke: representative input reflection and testcase verdict drive the final ID judgment.");
  if (!resetValidationHarnessIfNeeded())
  {
    return;
  }
  gTmuLinkState = -1;
  gTmuServiceMode = -1;
  gRemoteClimateReq = -1;
  gSignalBars = -1;
  gDKeyState = -1;
  gAuthMode = -1;
  gVehicleAccessState = -1;
  gSecurityGrade = -1;
  gKeyPresence = -1;
  if (!launchScenarioAndWait(229, 1500, 450))
  {
    return;
  }
  if (!waitForServiceAccessState(1200))
  {
    resetValidationHarnessIfNeeded();
    return;
  }
  assertIntEq("ivi-access-tmu-link", 2, gTmuLinkState, "TmuLinkState");
  assertIntEq("ivi-access-tmu-service", 1, gTmuServiceMode, "TmuServiceMode");
  assertIntEq("ivi-access-tmu-remote", 1, gRemoteClimateReq, "RemoteClimateReq");
  assertIntEq("ivi-access-dkey-state", 2, gDKeyState, "DKeyState");
  assertIntEq("ivi-access-auth", 2, gAuthMode, "AuthMode");
  assertIntEq("ivi-access-vehicle-access", 2, gVehicleAccessState, "VehicleAccessState");
  assertIntEq("ivi-access-grade", 2, gSecurityGrade, "SecurityGrade");
  assertIntEq("ivi-access-presence", 1, gKeyPresence, "KeyPresence");

  testStepPass("doc-pass", "PASS - UT_022 - 디지털 키와 차량 서비스 상태를 수신하여 사용자 안내에 반영");
  resetValidationHarnessIfNeeded();
}