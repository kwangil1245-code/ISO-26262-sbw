/*@!Encoding:65001*/
includes
{
  #include "..\\common\\ValidationHarnessTestCommon.cin"
}

variables
{
  long gAutoDoorState;
  long gAutoUnlockState;
  long gDoorApproachScore;
  long gTailgateAssistMode;
  long gTailgateOpenReq;
  long gTailgateActuatorCmd;
  long gDeploymentArmed;
  long gPretensionReq;
  long gAirbagWarn;
  long gOccupantDetected;
  long gWeightClass;
  long gAirbagSuppress;
  long gChildSeatDetected;
  long gCabinSetTemp;
  long gBlowerLevel;
  long gAcOn;
  long gVentMode;
  long gDefogMode;
  long gFanRpmStep;
}

on message frmAutoDoorCtrlStateMsg
{
  gAutoDoorState = this.AutoDoorState;
  gAutoUnlockState = this.AutoUnlockState;
  gDoorApproachScore = this.DoorApproachScore;
}

on message frmPowerTailgateCtrlStateMsg
{
  gTailgateAssistMode = this.TailgateAssistMode;
  gTailgateOpenReq = this.OpenRequestState;
  gTailgateActuatorCmd = this.TailgateActuatorCmd;
}

on message frmAcuStateMsg
{
  gDeploymentArmed = this.DeploymentArmed;
  gPretensionReq = this.PretensionReq;
  gAirbagWarn = this.AirbagWarn;
}

on message frmOdsStateMsg
{
  gOccupantDetected = this.OccupantDetected;
  gWeightClass = this.WeightClass;
  gAirbagSuppress = this.AirbagSuppress;
  gChildSeatDetected = this.ChildSeatDetected;
}

on message frmHvacStateMsg
{
  gCabinSetTemp = this.CabinSetTemp;
  gBlowerLevel = this.BlowerLevel;
  gAcOn = this.AcCompressorOn;
}

on message frmHvacActuatorMsg
{
  gVentMode = this.VentMode;
  gDefogMode = this.DefogMode;
  gFanRpmStep = this.FanRpmStep;
}

long waitForDoorEntryContext(dword timeoutMs)
{
  dword waitedMs;

  waitedMs = 0;
  while ((gAutoDoorState != 1 ||
          gAutoUnlockState != 1 ||
          gDoorApproachScore < 80) &&
         waitedMs < timeoutMs)
  {
    TestWaitForTimeout(50);
    waitedMs += 50;
  }

  if (gAutoDoorState != 1 ||
      gAutoUnlockState != 1 ||
      gDoorApproachScore < 80)
  {
    testStepPass("door-entry-context", "Door entry timeout waited=%d state=%d unlock=%d score=%d",
                 waitedMs, gAutoDoorState, gAutoUnlockState, gDoorApproachScore);
    return 0;
  }

  return 1;
}

long waitForTailgateContext(dword timeoutMs)
{
  dword waitedMs;

  waitedMs = 0;
  while ((gTailgateAssistMode != 2 ||
          gTailgateOpenReq != 1 ||
          gTailgateActuatorCmd != 0) &&
         waitedMs < timeoutMs)
  {
    TestWaitForTimeout(50);
    waitedMs += 50;
  }

  if (gTailgateAssistMode != 2 ||
      gTailgateOpenReq != 1 ||
      gTailgateActuatorCmd != 0)
  {
    testStepPass("tailgate-context", "Tailgate timeout waited=%d mode=%d open=%d cmd=%d",
                 waitedMs, gTailgateAssistMode, gTailgateOpenReq, gTailgateActuatorCmd);
    return 0;
  }

  return 1;
}

long waitForOccupantContext(dword timeoutMs)
{
  dword waitedMs;

  waitedMs = 0;
  while ((gDeploymentArmed != 0 ||
          gPretensionReq != 1 ||
          gAirbagWarn != 1 ||
          gOccupantDetected != 1 ||
          gWeightClass != 1 ||
          gAirbagSuppress != 1 ||
          gChildSeatDetected != 1) &&
         waitedMs < timeoutMs)
  {
    TestWaitForTimeout(50);
    waitedMs += 50;
  }

  if (gDeploymentArmed != 0 ||
      gPretensionReq != 1 ||
      gAirbagWarn != 1 ||
      gOccupantDetected != 1 ||
      gWeightClass != 1 ||
      gAirbagSuppress != 1 ||
      gChildSeatDetected != 1)
  {
    testStepPass("occupant-context", "Occupant timeout waited=%d armed=%d pretension=%d warn=%d detected=%d weight=%d suppress=%d child=%d",
                 waitedMs, gDeploymentArmed, gPretensionReq, gAirbagWarn, gOccupantDetected, gWeightClass, gAirbagSuppress, gChildSeatDetected);
    return 0;
  }

  return 1;
}

long waitForComfortHvacContext(dword timeoutMs)
{
  dword waitedMs;

  waitedMs = 0;
  while ((gCabinSetTemp != 24 ||
          gBlowerLevel != 5 ||
          gAcOn != 1 ||
          gVentMode != 2 ||
          gDefogMode != 0 ||
          gFanRpmStep != 80) &&
         waitedMs < timeoutMs)
  {
    TestWaitForTimeout(50);
    waitedMs += 50;
  }

  if (gCabinSetTemp != 24 ||
      gBlowerLevel != 5 ||
      gAcOn != 1 ||
      gVentMode != 2 ||
      gDefogMode != 0 ||
      gFanRpmStep != 80)
  {
    testStepPass("comfort-hvac-context", "Comfort HVAC timeout waited=%d set=%d blower=%d ac=%d vent=%d defog=%d fan=%d",
                 waitedMs, gCabinSetTemp, gBlowerLevel, gAcOn, gVentMode, gDefogMode, gFanRpmStep);
    return 0;
  }

  return 1;
}

export testcase TC_CANOE_IT_EXT_037_OCCUPANT_COMFORT_CONTEXT()
{
  testStepPass("doc-trace", "IT_037 - 도어, 테일게이트, 에어백, 탑승자 감지, 공조, 시트, 선루프 상태 통합 검증");
  testStepPass("closeout-smoke", "Closeout smoke: representative input reflection and testcase verdict drive the final ID judgment.");
  if (!resetValidationHarnessIfNeeded()) { return; }
  if (!launchScenarioAndWait(226, 900, 1300)) { return; }
  if (!waitForDoorEntryContext(800)) { resetValidationHarnessIfNeeded(); return; }
  assertIntEq("it-door-entry-state", 1, gAutoDoorState, "AutoDoorState");
  assertIntEq("it-door-entry-unlock", 1, gAutoUnlockState, "AutoUnlockState");
  assertIntMin("it-door-entry-score", 80, gDoorApproachScore, "DoorApproachScore");
  if (!resetValidationHarnessIfNeeded()) { return; }
  if (!launchScenarioAndWait(227, 900, 1300)) { return; }
  if (!waitForTailgateContext(800)) { resetValidationHarnessIfNeeded(); return; }
  assertIntEq("it-tailgate-mode", 2, gTailgateAssistMode, "TailgateAssistMode");
  assertIntEq("it-tailgate-open", 1, gTailgateOpenReq, "OpenRequestState");
  assertIntEq("it-tailgate-cmd", 0, gTailgateActuatorCmd, "TailgateActuatorCmd");
  if (!resetValidationHarnessIfNeeded()) { return; }
  if (!launchScenarioAndWait(228, 900, 1300)) { return; }
  if (!waitForOccupantContext(800)) { resetValidationHarnessIfNeeded(); return; }
  assertIntEq("it-occupant-armed", 0, gDeploymentArmed, "DeploymentArmed");
  assertIntEq("it-occupant-pretension", 1, gPretensionReq, "PretensionReq");
  assertIntEq("it-occupant-airbag-warn", 1, gAirbagWarn, "AirbagWarn");
  assertIntEq("it-occupant-detected", 1, gOccupantDetected, "OccupantDetected");
  assertIntEq("it-occupant-weight-class", 1, gWeightClass, "WeightClass");
  assertIntEq("it-occupant-airbag-suppress", 1, gAirbagSuppress, "AirbagSuppress");
  assertIntEq("it-occupant-child-seat", 1, gChildSeatDetected, "ChildSeatDetected");
  if (!resetValidationHarnessIfNeeded()) { return; }
  if (!launchScenarioAndWait(229, 1300, 1700)) { return; }
  if (!waitForComfortHvacContext(1200)) { resetValidationHarnessIfNeeded(); return; }
  assertIntEq("it-comfort-hvac-set", 24, gCabinSetTemp, "CabinSetTemp");
  assertIntEq("it-comfort-hvac-blower", 5, gBlowerLevel, "BlowerLevel");
  assertIntEq("it-comfort-hvac-ac", 1, gAcOn, "AcCompressorOn");
  assertIntEq("it-comfort-hvac-vent", 2, gVentMode, "VentMode");
  assertIntEq("it-comfort-hvac-defog", 0, gDefogMode, "DefogMode");
  assertIntEq("it-comfort-hvac-fan", 80, gFanRpmStep, "FanRpmStep");
  testStepPass("doc-pass", "PASS - IT_037 - 도어, 테일게이트, 에어백, 탑승자 감지, 공조, 시트, 선루프 상태 통합 검증");
  resetValidationHarnessIfNeeded();
}