/*@!Encoding:65001*/
includes
{
  #include "..\common\ValidationHarnessTestCommon.cin"
}

variables
{
}

export testcase TC_CANOE_ST_034_DUPLICATE_POPUP_GUARD()
{
  testStepPass("doc-trace", "ST_034 - 짧은 시간 내 동일 경고가 재진입해도 중복 팝업 억제와 경고 안내 안정성이 유지되는지 확인한다.");
  testStepPass("closeout-smoke", "Closeout smoke: representative input reflection and testcase verdict drive the final ID judgment.");
  if (!resetValidationHarnessIfNeeded())
  {
    return;
  }

  if (!launchScenarioAndWait(12, 900, 1400))
  {
    return;
  }

  if (!waitForCoreSelectedAlertState(3, 3, 800) ||
      !waitForDuplicatePopupGuard(1, 800))
  {
    resetValidationHarnessIfNeeded();
    return;
  }

  assertIntMin("delay-stability-guard", 1, (long)@CoreState::duplicatePopupGuard, "duplicatePopupGuard");

  testStepPass("doc-pass", "PASS - ST_034 - 짧은 시간 내 동일 경고가 재진입해도 중복 팝업 억제와 경고 안내 안정성이 유지되는지 확인한다.");
  resetValidationHarnessIfNeeded();
}