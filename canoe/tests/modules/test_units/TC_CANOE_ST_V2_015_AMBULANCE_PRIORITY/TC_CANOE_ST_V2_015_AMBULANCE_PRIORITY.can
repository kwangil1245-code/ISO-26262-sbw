/*@!Encoding:65001*/
includes
{
  #include "..\\common\\ValidationHarnessTestCommon.cin"
}

variables
{
}

export testcase TC_CANOE_ST_V2_015_AMBULANCE_PRIORITY()
{
  testStepPass("doc-trace", "ST_015 - 동일 접근 조건에서 경찰차와 구급차 긴급 알림이 동시에 수신될 때 구급 경고가 우선 선택되는지 확인한다.");
  testStepPass("closeout-smoke", "Closeout smoke: representative input reflection and testcase verdict drive the final ID judgment.");
  if (!resetValidationHarnessIfNeeded())
  {
    return;
  }

  if (!launchScenarioAndWait(212, 700, 1200))
  {
    return;
  }

if (!waitForV2xIngressState(1, 2, 8, 22, 1500))
  {
    resetValidationHarnessIfNeeded();
    return;
  }

  assertIntEq("ambulance-priority-emergency-type", 2, (long)@V2X::emergencyType, "emergencyType");
  if (!waitForObservedSelectedAlertState(7, 2, 800))
  {
    resetValidationHarnessIfNeeded();
    return;
  }
  assertIntEq("ambulance-priority-level", 7, (long)@Test::obsSelectedAlertLevel, "ethSelectedAlertLevel");
  assertIntEq("ambulance-priority-alert-type", 2, (long)@Test::obsSelectedAlertType, "ethSelectedAlertType");
  assertIntEq("ambulance-priority-warning-code", deriveExpectedEmergencyWarningCode(2, 2, 8, 20), (long)@Cluster::warningTextCode, "warningTextCode");

  testStepPass("doc-pass", "PASS - ST_015 - 동일 접근 조건에서 경찰차와 구급차 긴급 알림이 동시에 수신될 때 구급 경고가 우선 선택되는지 확인한다.");
  resetValidationHarnessIfNeeded();
}