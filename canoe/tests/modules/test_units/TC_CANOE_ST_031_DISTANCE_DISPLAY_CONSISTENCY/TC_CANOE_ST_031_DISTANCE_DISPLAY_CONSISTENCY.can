/*@!Encoding:65001*/
includes
{
  #include "..\common\ValidationHarnessTestCommon.cin"
}

variables
{
}

export testcase TC_CANOE_ST_031_DISTANCE_DISPLAY_CONSISTENCY()
{
  testStepPass("doc-trace", "ST_031 - 긴급 접근거리 표시가 경고 안내와 함께 사용자 화면에 일관되게 반영되는지 확인한다.");
  testStepPass("closeout-smoke", "Closeout smoke: representative input reflection and testcase verdict drive the final ID judgment.");
  if (!resetValidationHarnessIfNeeded())
  {
    return;
  }

  if (!launchScenarioAndWait(222, 900, 1300))
  {
    return;
  }

  if (!waitForStableDistanceHistory(180, deriveExpectedEmergencyWarningCode(1, 2, 9, 72), 1, 1200))
  {
    resetValidationHarnessIfNeeded();
    return;
  }
  assertIntEq("context-adjust-distance", 180, (long)@CoreState::emergencyDistanceM, "emergencyDistanceM");
  assertIntEq("context-adjust-code", deriveExpectedEmergencyWarningCode(1, 2, 9, 72), (long)@Cluster::warningTextCode, "warningTextCode");
  assertIntEq("context-adjust-failsafe-clear", 0, (long)@Core::failSafeMode, "failSafeMode");

  testStepPass("doc-pass", "PASS - ST_031 - 긴급 접근거리 표시가 경고 안내와 함께 사용자 화면에 일관되게 반영되는지 확인한다.");
  resetValidationHarnessIfNeeded();
}