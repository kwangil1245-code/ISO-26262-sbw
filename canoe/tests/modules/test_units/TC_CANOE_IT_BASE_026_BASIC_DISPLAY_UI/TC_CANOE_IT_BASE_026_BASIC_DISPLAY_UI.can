/*@!Encoding:65001*/
includes
{
  #include "..\\common\\ValidationHarnessTestCommon.cin"
}

variables
{
}

export testcase TC_CANOE_IT_BASE_026_BASIC_DISPLAY_UI()
{
  testStepPass("doc-trace", "IT_026 - 기본 표시 및 UI 연동 통합 검증");
  testStepPass("closeout-smoke", "Closeout smoke: representative input reflection and testcase verdict drive the final ID judgment.");
  if (!resetValidationHarnessIfNeeded())
  {
    return;
  }

  if (!launchScenarioAndWait(220, 900, 1300))
  {
    return;
  }

  if (!waitForStableDisplayPolicy(2, 1, 1, 1, 1200))
  {
    resetValidationHarnessIfNeeded();
    return;
  }
  assertIntEq("display-ui-level", 3, getCanonicalSelectedAlertLevel(), "selectedAlertLevel");
  assertIntEq("display-ui-type", 3, getCanonicalSelectedAlertType(), "selectedAlertType");
  assertIntEq("display-ui-theme", 2, (long)@CoreState::themeMode, "themeMode");
  assertIntEq("display-ui-popup-active", 1, (long)@CoreState::popupActive, "popupActive");
  assertIntEq("display-ui-popup-prio", 1, (long)@CoreState::popupPriority, "popupPriority");
  assertIntEq("display-ui-sync", 1, (long)@CoreState::clusterSyncState, "clusterSyncState");

  testStepPass("doc-pass", "PASS - IT_026 - 기본 표시 및 UI 연동 통합 검증");
  resetValidationHarnessIfNeeded();
}