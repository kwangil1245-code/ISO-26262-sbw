/*@!Encoding:65001*/
includes
{
  #include "..\\common\\ValidationHarnessTestCommon.cin"
}

variables
{
}

export testcase TC_CANOE_IT_V2_004_POLICE_RX()
{
  testStepPass("doc-trace", "IT_004 - 경찰 긴급 알림 수신 및 경고 반영 통합 검증");
  testStepPass("closeout-smoke", "Closeout smoke: representative input reflection and testcase verdict drive the final ID judgment.");
  if (!resetValidationHarnessIfNeeded())
  {
    return;
  }

  if (!launchScenarioAndWait(4, 700, 1200))
  {
    return;
  }

if (!waitForV2xIngressState(1, 1, 12, 11, 1500))
  {
    resetValidationHarnessIfNeeded();
    return;
  }

  if (!waitForObservedSelectedAlertState(6, 1, 800) ||
      !waitForObservedFailSafe(1200))
  {
    resetValidationHarnessIfNeeded();
    return;
  }
  assertIntEq("selected-alert-level", 6, (long)@Test::obsSelectedAlertLevel, "ethSelectedAlertLevel");
  assertIntEq("selected-alert-type", 1, (long)@Test::obsSelectedAlertType, "ethSelectedAlertType");
  assertIntEq("eta", 12, (long)@V2X::eta, "eta");
  assertIntEq("source-id", 11, (long)@V2X::sourceId, "sourceId");
  assertIntEq("fail-safe-clear", 0, (long)@Test::obsFailSafeMode, "ethFailSafeMode");

  testStepPass("doc-pass", "PASS - IT_004 - 경찰 긴급 알림 수신 및 경고 반영 통합 검증");
  resetValidationHarnessIfNeeded();
}