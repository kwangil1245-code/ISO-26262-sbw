/*@!Encoding:65001*/
includes
{
  #include "..\common\ValidationHarnessTestCommon.cin"
}

variables
{
}

export testcase TC_CANOE_UT_INP_028_VEHICLE_STEERING()
{
  testStepPass("doc-trace", "UT_028 - 차량 속도(km/h), 주행 상태, 조향 각도 입력 정보를 생성");
  testStepPass("closeout-smoke", "Closeout smoke: representative input reflection and testcase verdict drive the final ID judgment.");
  if (!resetValidationHarnessIfNeeded())
  {
    return;
  }

  if (!launchScenarioAndWait(217, 800, 1300))
  {
    return;
  }

  if (!waitForCoreDriveStateMinSpeed(3, 30, 0, 800))
  {
    resetValidationHarnessIfNeeded();
    return;
  }

  assertIntEq("s217_driveStateNorm", 3, (long)@Core::driveStateNorm, "driveStateNorm");
  assertIntMin("s217_vehicleSpeedNorm", 30, (long)@Core::vehicleSpeedNorm, "vehicleSpeedNorm");
  assertIntEq("s217_failSafeMode", 0, (long)@Core::failSafeMode, "failSafeMode");

  if (!resetValidationHarnessIfNeeded())
  {
    return;
  }

  if (!launchScenarioAndWait(218, 800, 1300))
  {
    return;
  }

  if (!waitForCoreChassisState(68, 1, -1, -1, 800))
  {
    resetValidationHarnessIfNeeded();
    return;
  }

  assertIntEq("s218_steeringInputNorm", 1, (long)@Core::steeringInputNorm, "steeringInputNorm");
  assertIntEq("s218_vehicleSpeedNorm", 68, (long)@Core::vehicleSpeedNorm, "vehicleSpeedNorm");

  testStepPass("doc-pass", "PASS - UT_028 - 차량 속도(km/h), 주행 상태, 조향 각도 입력 정보를 생성");
  resetValidationHarnessIfNeeded();
}