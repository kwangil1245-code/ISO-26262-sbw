/*@!Encoding:65001*/
includes
{
  #include "..\common\ValidationHarnessTestCommon.cin"
}

variables
{
}

export testcase TC_CANOE_ST_030_SEATBELT_CONTEXT_ADJUST()
{
  testStepPass("doc-trace", "ST_030 - 안전벨트 및 운전자 상태 변화가 발생할 때 시스템 경고 안내가 맥락에 맞게 보정되는지 확인한다.");
  testStepPass("closeout-smoke", "Closeout smoke: representative input reflection and testcase verdict drive the final ID judgment.");
  if (!resetValidationHarnessIfNeeded())
  {
    return;
  }

  if (!launchScenarioAndWait(214, 900, 1300))
  {
    return;
  }

  if (!waitForCoreSelectedAlertState(5, 3, 800) ||
      !waitForCoreDriveState(-1, -1, 0, 800))
  {
    resetValidationHarnessIfNeeded();
    return;
  }

  assertIntEq("context-adjust-alert-level", 5, getCanonicalSelectedAlertLevel(), "selectedAlertLevel");
  assertIntEq("context-adjust-alert-type", 3, getCanonicalSelectedAlertType(), "selectedAlertType");
  assertIntEq("context-adjust-failsafe", 0, (long)@Core::failSafeMode, "failSafeMode");

  testStepPass("doc-pass", "PASS - ST_030 - 안전벨트 및 운전자 상태 변화가 발생할 때 시스템 경고 안내가 맥락에 맞게 보정되는지 확인한다.");
  resetValidationHarnessIfNeeded();
}