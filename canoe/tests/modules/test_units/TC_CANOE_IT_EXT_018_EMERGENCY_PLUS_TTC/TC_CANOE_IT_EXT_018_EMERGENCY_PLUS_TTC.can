/*@!Encoding:65001*/
includes
{
  #include "..\\common\\ValidationHarnessTestCommon.cin"
}

variables
{
}

export testcase TC_CANOE_IT_EXT_018_EMERGENCY_PLUS_TTC()
{
  testStepPass("doc-trace", "IT_018 - 긴급차량 접근과 교차로/합류 TTC 충돌 위험 동시 입력 시 우선 경고 선택 통합 검증");
  testStepPass("closeout-smoke", "Closeout smoke: representative input reflection and testcase verdict drive the final ID judgment.");
  if (!resetValidationHarnessIfNeeded())
  {
    return;
  }

  if (!launchScenarioAndWait(213, 800, 1300))
  {
    return;
  }

  assertIntEq("emergency-plus-ttc-emergency-type", 2, (long)@V2X::emergencyType, "emergencyType");
  if (!waitForObservedDecelState(1, 1, 0, 1500) ||
      !waitForObservedIntersectionConflict(1500) ||
      !waitForObservedSelectedAlertState(7, 2, 1500))
  {
    resetValidationHarnessIfNeeded();
    return;
  }
  assertIntEq("emergency-plus-ttc-intersection", 1, (long)@Test::obsIntersectionConflictFlag, "ethIntersectionConflictFlag");
  assertIntEq("emergency-plus-ttc-decision", 1, (long)@Test::obsDecelDecisionReq, "ethDecelDecisionReq");
  assertIntEq("emergency-plus-ttc-decel", 1, (long)@Test::obsDecelAssistReq, "ethDecelAssistReq");
  assertIntEq("emergency-plus-ttc-gate-clear", 0, (long)@Test::obsDecelGateReason, "ethDecelGateReason");
  assertIntEq("emergency-plus-ttc-level", 7, (long)@Test::obsSelectedAlertLevel, "ethSelectedAlertLevel");
  assertIntEq("emergency-plus-ttc-type", 2, (long)@Test::obsSelectedAlertType, "ethSelectedAlertType");

  testStepPass("doc-pass", "PASS - IT_018 - 긴급차량 접근과 교차로/합류 TTC 충돌 위험 동시 입력 시 우선 경고 선택 통합 검증");
  resetValidationHarnessIfNeeded();
}